## boards/silabs/xg22_ek2710a/Kconfig
```kconfig
# EFR32xG22E Explorer Kit (BRD2710A)

# Copyright (c) 2025 blerpc project
# SPDX-License-Identifier: Apache-2.0

module = BOARD_XG22_EK2710A
module-str = Board Control
source "subsys/logging/Kconfig.template.log_config"
```

## boards/silabs/xg22_ek2710a/Kconfig.defconfig
```kconfig
# EFR32xG22E Explorer Kit (BRD2710A)

# Copyright (c) 2025 blerpc project
# SPDX-License-Identifier: Apache-2.0

config CMU_HFXO_FREQ
	default 38400000

config CMU_LFXO_FREQ
	default 32768

if BT

config FPU
	default y

config COMMON_LIBC_MALLOC_ARENA_SIZE
	default 8192

config MAIN_STACK_SIZE
	default 3072 if PM
	default 2304

endif # BT
```

## boards/silabs/xg22_ek2710a/Kconfig.xg22_ek2710a
```kconfig
# EFR32xG22E Explorer Kit (BRD2710A)

# Copyright (c) 2025 blerpc project
# SPDX-License-Identifier: Apache-2.0

config BOARD_XG22_EK2710A
	select SOC_PART_NUMBER_EFR32BG22C224F512IM40
```

## boards/silabs/xg22_ek2710a/board.yml
```yaml
boards:
  - name: xg22_ek2710a
    full_name: EFR32xG22E Explorer Kit (BRD2710A)
    vendor: silabs
    socs:
      - name: efr32bg22c224f512im40
```

## peripheral/tests/testcase.yaml
```yaml
tests:
  blerpc.container_command:
    tags: blerpc
    platform_allow: native_posix
```
