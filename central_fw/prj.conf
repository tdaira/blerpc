## CMakeLists.txt
```
cmake_minimum_required(VERSION 3.20.0)

# blerpc-protocol library (container + command layers)
set(BLERPC_PROTOCOL_DIR ${CMAKE_CURRENT_SOURCE_DIR}/../../blerpc-protocol/c
    CACHE PATH "Path to blerpc-protocol C library")
list(APPEND ZEPHYR_EXTRA_MODULES ${BLERPC_PROTOCOL_DIR})

find_package(Zephyr REQUIRED HINTS $ENV{ZEPHYR_BASE})
project(blerpc_central)

# nanopb
list(APPEND CMAKE_MODULE_PATH ${ZEPHYR_BASE}/../modules/lib/nanopb/extra)
include(FindNanopb)

target_sources(app PRIVATE
    src/main.c
    src/ble_central.c
    src/generated_client.c
)

# Generate the nanopb message code (blerpc.pb.c/.h) from the proto at build
# time so it always matches proto/blerpc.proto and proto/blerpc.options.
# Resolve to an absolute path (no "..") so protoc does not report the input as
# shadowed in --proto_path.
get_filename_component(BLERPC_PROTO_DIR ${CMAKE_CURRENT_SOURCE_DIR}/../proto ABSOLUTE)
# The nanopb runtime is already provided by CONFIG_NANOPB; keep standalone mode
# off so nanopb_generate_cpp does not add a duplicate runtime (multiple-definition).
set(NANOPB_GENERATE_CPP_STANDALONE OFF)
nanopb_generate_cpp(proto_srcs proto_hdrs
    RELPATH ${BLERPC_PROTO_DIR}
    ${BLERPC_PROTO_DIR}/blerpc.proto)
target_sources(app PRIVATE ${proto_srcs} ${proto_hdrs})

target_include_directories(app PRIVATE
    src
    ${CMAKE_CURRENT_BINARY_DIR}
)

# Match generated client response buffer to assembler buffer size
target_compile_definitions(app PRIVATE
    BLERPC_GENERATED_RESP_BUF_SIZE=CONFIG_BLERPC_PROTOCOL_ASSEMBLER_BUF_SIZE
)
```

## Kconfig
```
source "Kconfig.zephyr"

config BLERPC_ENCRYPTION
	bool "Enable E2E encryption"
	default n
	depends on BLERPC_PROTOCOL_CRYPTO
	help
	  Enable E2E encryption on the central.

config BLERPC_PEER_ED25519_PUBLIC_KEY
	string "Pinned peripheral Ed25519 public key (hex, 64 chars)"
	default ""
	depends on BLERPC_ENCRYPTION
	help
	  The expected peripheral's Ed25519 identity public key as 64 hex chars
	  (32 bytes). The central pins this value and refuses to establish a
	  session with any peripheral whose identity key differs — this is what
	  makes the handshake resistant to a man-in-the-middle. Store it in a
	  git-ignored overlay file (e.g. keys.conf), like the peripheral's key.

config BLERPC_PEER_DEVICE_NAME
	string "Expected peripheral device name (empty = accept any)"
	default ""
	help
	  When set, the central only connects to an advertiser whose complete or
	  shortened local name matches this string exactly. The bleRPC service UUID
	  alone is not a unique filter — other products advertise it too — so
	  without a name the central connects to whichever matching peripheral it
	  happens to see first. Leave empty to accept any bleRPC advertiser.
```

## prj.conf
```kconfig
# Bluetooth
CONFIG_BT=y
CONFIG_BT_CENTRAL=y
CONFIG_BT_GATT_CLIENT=y
CONFIG_BT_DEVICE_NAME="blerpc-central"

# MTU
CONFIG_BT_L2CAP_TX_MTU=247
CONFIG_BT_BUF_ACL_TX_SIZE=251
CONFIG_BT_BUF_ACL_RX_SIZE=251
# TX buffers
CONFIG_BT_L2CAP_TX_BUF_COUNT=20
CONFIG_BT_BUF_ACL_TX_COUNT=20
CONFIG_BT_CONN_TX_MAX=20

# nanopb
CONFIG_NANOPB=y

# Logging
CONFIG_LOG=y
CONFIG_LOG_DEFAULT_LEVEL=3

# Console via UART
CONFIG_CONSOLE=y
CONFIG_UART_CONSOLE=y
CONFIG_SERIAL=y

# UART logging backend
CONFIG_LOG_BACKEND_UART=y

# RTT logging backend
CONFIG_USE_SEGGER_RTT=y
CONFIG_LOG_BACKEND_RTT=y
CONFIG_LOG_BACKEND_RTT_MODE_DROP=y

# blerpc-protocol
CONFIG_BLERPC_PROTOCOL_ASSEMBLER_BUF_SIZE=12288

# Stack sizes
CONFIG_MAIN_STACK_SIZE=8192
CONFIG_SYSTEM_WORKQUEUE_STACK_SIZE=2048
CONFIG_BT_RX_STACK_SIZE=4096

# Heap for mbedTLS/PSA crypto operations
CONFIG_HEAP_MEM_POOL_SIZE=16384

# E2E Encryption
CONFIG_BLERPC_PROTOCOL_CRYPTO=y
CONFIG_BLERPC_ENCRYPTION=y
CONFIG_MBEDTLS=y
CONFIG_MBEDTLS_PSA_CRYPTO_C=y

# PSA algorithm support for E2E encryption
# X25519 ECDH key agreement
CONFIG_PSA_WANT_ALG_ECDH=y
CONFIG_PSA_WANT_ECC_MONTGOMERY_255=y
CONFIG_PSA_WANT_KEY_TYPE_ECC_KEY_PAIR_IMPORT=y
CONFIG_PSA_WANT_KEY_TYPE_ECC_KEY_PAIR_EXPORT=y
CONFIG_PSA_WANT_KEY_TYPE_ECC_KEY_PAIR_DERIVE=y
CONFIG_PSA_WANT_KEY_TYPE_ECC_PUBLIC_KEY=y
# Ed25519 signatures
CONFIG_PSA_WANT_ALG_PURE_EDDSA=y
CONFIG_PSA_WANT_ECC_TWISTED_EDWARDS_255=y
# AES-128-GCM
CONFIG_PSA_WANT_KEY_TYPE_AES=y
CONFIG_PSA_WANT_ALG_GCM=y
# HKDF-SHA256
CONFIG_PSA_WANT_ALG_HKDF=y
# SHA-512 required for Ed25519 (CRACEN workmem needs PSA_HASH_MAX_SIZE >= 64)
CONFIG_PSA_WANT_ALG_SHA_512=y
```

## boards/nrf54l15dk_nrf54l15_cpuapp.conf
```kconfig
# Nordic-specific: software BLE controller supports DLE
CONFIG_BT_CTLR_DATA_LENGTH_MAX=251
CONFIG_BT_USER_DATA_LEN_UPDATE=y
```

## src/main.c
```c
#include <zephyr/kernel.h>
#include <zephyr/bluetooth/bluetooth.h>
#include <zephyr/logging/log.h>
#include <string.h>

#include "ble_central.h"
#include <blerpc_protocol/container.h>
#include <blerpc_protocol/command.h>
#include "generated_client.h"
#ifdef CONFIG_BLERPC_ENCRYPTION
#include <mbedtls/platform.h>
#endif

LOG_MODULE_REGISTER(main, LOG_LEVEL_INF);

/* Max test payload adapts to assembler buffer size (leave headroom for headers) */
#define MAX_TEST_PAYLOAD (CONFIG_BLERPC_PROTOCOL_ASSEMBLER_BUF_SIZE - 128)

/* Response buffer and synchronization */
static uint8_t response_buf[CONFIG_BLERPC_PROTOCOL_ASSEMBLER_BUF_SIZE];
static size_t response_len;

/* Shared encryption buffer (reused across sequential calls) */
static uint8_t encrypt_buf[CONFIG_BLERPC_PROTOCOL_ASSEMBLER_BUF_SIZE + 20];

/* Shared work buffers (tests run sequentially, not concurrently) */
static uint8_t shared_cmd_buf[CONFIG_BLERPC_PROTOCOL_ASSEMBLER_BUF_SIZE];
static uint8_t shared_work_buf[CONFIG_BLERPC_PROTOCOL_ASSEMBLER_BUF_SIZE];
static uint8_t shared_decode_buf[CONFIG_BLERPC_PROTOCOL_ASSEMBLER_BUF_SIZE];

static int rpc_error_code;
static K_SEM_DEFINE(response_sem, 0, 10);

static uint8_t transaction_counter;

static uint8_t next_transaction_id(void)
{
    return transaction_counter++;
}

/* Callback from ble_central when a complete response is assembled */
static void on_response(const uint8_t *data, size_t len)
{
    if (len > sizeof(response_buf)) {
        LOG_ERR("Response too large: %zu > %zu", len, sizeof(response_buf));
        return;
    }
    memcpy(response_buf, data, len);
    response_len = len;
    rpc_error_code = 0;
    k_sem_give(&response_sem);
}

/* Callback from ble_central when an ERROR control container is received */
static void on_error(uint8_t error_code)
{
    LOG_ERR("Peripheral error: 0x%02x", error_code);
    rpc_error_code = error_code;
    k_sem_give(&response_sem);
}

/* Send container callback for container_split_and_send */
static int send_container(const uint8_t *data, size_t len, void *ctx)
{
    (void)ctx;
    return ble_central_write(data, len);
}

/* ── RPC transport functions (extern'd by generated_client.h) ────────── */

int blerpc_rpc_call(const char *cmd_name, const uint8_t *req_data, size_t req_len,
                    uint8_t *resp_data, size_t resp_size, size_t *resp_len)
{
    uint8_t name_len = (uint8_t)strlen(cmd_name);

    int cmd_len = command_serialize(COMMAND_TYPE_REQUEST, cmd_name, name_len, req_data,
                                    (uint16_t)req_len, shared_cmd_buf, sizeof(shared_cmd_buf));
    if (cmd_len < 0) {
        LOG_ERR("Command serialize failed");
        return -1;
    }

    uint16_t max_req = ble_central_get_max_request_payload_size();
    if (max_req > 0 && (size_t)cmd_len > max_req) {
        LOG_ERR("Request too large: %d > %u", cmd_len, max_req);
        return -1;
    }

    /* Encrypt if encryption is active */
    size_t send_len;
    if (ble_central_encrypt_payload(shared_cmd_buf, (size_t)cmd_len, encrypt_buf,
                                    sizeof(encrypt_buf), &send_len) != 0) {
        LOG_ERR("Payload encryption failed");
        return -1;
    }

    uint8_t tid = next_transaction_id();
    uint16_t mtu = ble_central_get_mtu();

    int rc = container_split_and_send(tid, encrypt_buf, send_len, mtu, send_container, NULL);
    if (rc < 0) {
        LOG_ERR("Container split/send failed: %d", rc);
        return -1;
    }

    /* Wait for response */
    rc = k_sem_take(&response_sem, K_SECONDS(10));
    if (rc != 0) {
        LOG_ERR("Response timeout");
        return -1;
    }

    if (rpc_error_code != 0) {
        LOG_ERR("RPC error from peripheral: 0x%02x", rpc_error_code);
        return -1;
    }

    /* Parse command response */
    struct command_packet resp_cmd;
    if (command_parse(response_buf, response_len, &resp_cmd) != 0) {
        LOG_ERR("Response command parse failed");
        return -1;
    }

    if (resp_cmd.cmd_type != COMMAND_TYPE_RESPONSE) {
        LOG_ERR("Expected response, got type %d", resp_cmd.cmd_type);
        return -1;
    }

    if (resp_cmd.cmd_name_len != name_len || memcmp(resp_cmd.cmd_name, cmd_name, name_len) != 0) {
        LOG_ERR("Command name mismatch in response");
        return -1;
    }

    if (resp_cmd.data_len > resp_size) {
        LOG_ERR("Response data too large: %u > %zu", resp_cmd.data_len, resp_size);
        return -1;
    }

    memcpy(resp_data, resp_cmd.data, resp_cmd.data_len);
    *resp_len = resp_cmd.data_len;
    return 0;
}

/* Stream end signaling for blerpc_stream_receive */
static volatile bool _stream_ended;

static void _stream_end_cb(void)
{
    _stream_ended = true;
    k_sem_give(&response_sem);
}

int blerpc_stream_receive(const char *cmd_name, const uint8_t *req_data, size_t req_len,
                          blerpc_on_stream_resp_t on_resp, void *ctx)
{
    uint8_t name_len = (uint8_t)strlen(cmd_name);

    _stream_ended = false;
    ble_central_set_stream_end_cb(_stream_end_cb);

    /* Serialize and send the initial request */
    int cmd_len = command_serialize(COMMAND_TYPE_REQUEST, cmd_name, name_len, req_data,
                                    (uint16_t)req_len, shared_cmd_buf, sizeof(shared_cmd_buf));
    if (cmd_len < 0) {
        LOG_ERR("Command serialize failed");
        ble_central_set_stream_end_cb(NULL);
        return -1;
    }

    size_t send_len;
    if (ble_central_encrypt_payload(shared_cmd_buf, (size_t)cmd_len, encrypt_buf,
                                    sizeof(encrypt_buf), &send_len) != 0) {
        LOG_ERR("Payload encryption failed");
        ble_central_set_stream_end_cb(NULL);
        return -1;
    }

    uint8_t tid = next_transaction_id();
    uint16_t mtu = ble_central_get_mtu();
    int rc = container_split_and_send(tid, encrypt_buf, send_len, mtu, send_container, NULL);
    if (rc < 0) {
        LOG_ERR("Container split/send failed: %d", rc);
        ble_central_set_stream_end_cb(NULL);
        return -1;
    }

    /* Receive responses until STREAM_END_P2C */
    while (true) {
        rc = k_sem_take(&response_sem, K_SECONDS(10));
        if (rc != 0) {
            LOG_ERR("Stream response timeout");
            ble_central_set_stream_end_cb(NULL);
            return -1;
        }

        if (_stream_ended) {
            break;
        }

        if (rpc_error_code != 0) {
            LOG_ERR("Stream error: 0x%02x", rpc_error_code);
            ble_central_set_stream_end_cb(NULL);
            return -1;
        }

        struct command_packet resp_cmd;
        if (command_parse(response_buf, response_len, &resp_cmd) != 0) {
            LOG_ERR("Stream response parse failed");
            ble_central_set_stream_end_cb(NULL);
            return -1;
        }

        if (on_resp(resp_cmd.data, resp_cmd.data_len, ctx) != 0) {
            LOG_ERR("Stream response callback failed");
            ble_central_set_stream_end_cb(NULL);
            return -1;
        }
    }

    ble_central_set_stream_end_cb(NULL);
    return 0;
}

int blerpc_stream_send(const char *cmd_name, size_t msg_count, blerpc_next_msg_t next_msg,
                       void *msg_ctx, const char *final_cmd_name, uint8_t *resp_data,
                       size_t resp_size, size_t *resp_len)
{
    (void)final_cmd_name;
    uint8_t name_len = (uint8_t)strlen(cmd_name);

    /* Send each message */
    for (size_t i = 0; i < msg_count; i++) {
        size_t msg_len;
        if (next_msg(i, shared_work_buf, sizeof(shared_work_buf), &msg_len, msg_ctx) != 0) {
            LOG_ERR("next_msg callback failed at %zu", i);
            return -1;
        }

        int cmd_len = command_serialize(COMMAND_TYPE_REQUEST, cmd_name, name_len, shared_work_buf,
                                        (uint16_t)msg_len, shared_cmd_buf, sizeof(shared_cmd_buf));
        if (cmd_len < 0) {
            LOG_ERR("Command serialize failed at %zu", i);
            return -1;
        }

        size_t send_len;
        if (ble_central_encrypt_payload(shared_cmd_buf, (size_t)cmd_len, encrypt_buf,
                                        sizeof(encrypt_buf), &send_len) != 0) {
            LOG_ERR("Payload encryption failed at %zu", i);
            return -1;
        }

        uint8_t tid = next_transaction_id();
        uint16_t mtu = ble_central_get_mtu();
        int rc = container_split_and_send(tid, encrypt_buf, send_len, mtu, send_container, NULL);
        if (rc < 0) {
            LOG_ERR("Container split/send failed at %zu: %d", i, rc);
            return -1;
        }
    }

    /* Send STREAM_END_C2P */
    if (ble_central_send_stream_end_c2p() < 0) {
        LOG_ERR("STREAM_END_C2P send failed");
        return -1;
    }

    /* Wait for final response */
    int rc = k_sem_take(&response_sem, K_SECONDS(10));
    if (rc != 0) {
        LOG_ERR("Final response timeout");
        return -1;
    }

    if (rpc_error_code != 0) {
        LOG_ERR("RPC error from peripheral: 0x%02x", rpc_error_code);
        return -1;
    }

    struct command_packet resp_cmd;
    if (command_parse(response_buf, response_len, &resp_cmd) != 0) {
        LOG_ERR("Response command parse failed");
        return -1;
    }

    if (resp_cmd.data_len > resp_size) {
        LOG_ERR("Response data too large: %u > %zu", resp_cmd.data_len, resp_size);
        return -1;
    }

    memcpy(resp_data, resp_cmd.data, resp_cmd.data_len);
    *resp_len = resp_cmd.data_len;
    return 0;
}

/* ── Test functions ──────────────────────────────────────────────────── */

static int test_echo(void)
{
    LOG_INF("=== Echo Test ===");

    static const char msg[] = "Hello from nRF54L15 central!";

    blerpc_EchoResponse resp;
    if (blerpc_echo(msg, &resp) != 0) {
        LOG_ERR("Echo RPC failed");
        return -1;
    }

    LOG_INF("Echo response: '%s'", resp.message);

    if (strcmp(resp.message, msg) != 0) {
        LOG_ERR("Echo mismatch! Expected '%s', got '%s'", msg, resp.message);
        return -1;
    }

    LOG_INF("Echo test PASSED");
    return 0;
}

static int test_flash_read(uint32_t length)
{
    LOG_INF("=== FlashRead Test (len=%u) ===", length);

    blerpc_FlashReadResponse resp;
    size_t data_len;
    if (blerpc_flash_read(0x00000000, length, &resp, shared_decode_buf, sizeof(shared_decode_buf),
                          &data_len) != 0) {
        LOG_ERR("FlashRead RPC failed");
        return -1;
    }

    LOG_INF("FlashRead response: addr=0x%08x, data_len=%zu", resp.address, data_len);

    if (data_len != length) {
        LOG_ERR("FlashRead length mismatch: expected %u, got %zu", length, data_len);
        return -1;
    }

    LOG_INF("FlashRead test PASSED");
    return 0;
}

static int test_throughput(void)
{
    LOG_INF("=== Throughput Test (10x flash_read %u) ===", MAX_TEST_PAYLOAD);

    /* Warm up */
    if (test_flash_read(MAX_TEST_PAYLOAD) != 0) {
        LOG_ERR("Throughput warm-up failed");
        return -1;
    }

    uint32_t start = k_uptime_get_32();

    for (int i = 0; i < 10; i++) {
        if (test_flash_read(MAX_TEST_PAYLOAD) != 0) {
            LOG_ERR("Throughput test failed at iteration %d", i);
            return -1;
        }
    }

    uint32_t elapsed = k_uptime_get_32() - start;
    uint32_t total_bytes = 10 * MAX_TEST_PAYLOAD;
    uint32_t kbps = (total_bytes * 1000) / (elapsed * 1024);

    LOG_INF("Throughput: %u bytes in %u ms = %u KB/s", total_bytes, elapsed, kbps);
    LOG_INF("Throughput test PASSED");
    return 0;
}

static int test_data_write(uint32_t length)
{
    LOG_INF("=== DataWrite Test (len=%u) ===", length);

    /* Build incrementing pattern data */
    for (uint32_t i = 0; i < length; i++) {
        shared_decode_buf[i] = (uint8_t)(i & 0xFF);
    }

    blerpc_DataWriteResponse resp;
    if (blerpc_data_write(shared_decode_buf, length, shared_work_buf, sizeof(shared_work_buf),
                          &resp) != 0) {
        LOG_ERR("DataWrite RPC failed");
        return -1;
    }

    LOG_INF("DataWrite response: length=%u", resp.length);

    if (resp.length != length) {
        LOG_ERR("DataWrite length mismatch: expected %u, got %u", length, resp.length);
        return -1;
    }

    LOG_INF("DataWrite test PASSED");
    return 0;
}

static int test_write_throughput(void)
{
    LOG_INF("=== Write Throughput Test (10x data_write %u) ===", MAX_TEST_PAYLOAD);

    /* Warm up */
    if (test_data_write(MAX_TEST_PAYLOAD) != 0) {
        LOG_ERR("Write throughput warm-up failed");
        return -1;
    }

    uint32_t start = k_uptime_get_32();

    for (int i = 0; i < 10; i++) {
        if (test_data_write(MAX_TEST_PAYLOAD) != 0) {
            LOG_ERR("Write throughput test failed at iteration %d", i);
            return -1;
        }
    }

    uint32_t elapsed = k_uptime_get_32() - start;
    uint32_t total_bytes = 10 * MAX_TEST_PAYLOAD;
    uint32_t kbps = (total_bytes * 1000) / (elapsed * 1024);

    LOG_INF("Write throughput: %u bytes in %u ms = %u KB/s", total_bytes, elapsed, kbps);
    LOG_INF("Write throughput test PASSED");
    return 0;
}

static int test_counter_stream(void)
{
    LOG_INF("=== CounterStream Test ===");

    const uint32_t count = 5;
    blerpc_CounterStreamResponse results[10];
    size_t result_count;

    if (blerpc_counter_stream(count, results, 10, &result_count) != 0) {
        LOG_ERR("CounterStream failed");
        return -1;
    }

    for (size_t i = 0; i < result_count; i++) {
        if (results[i].seq != i || results[i].value != (int32_t)(i * 10)) {
            LOG_ERR("CounterStream mismatch at %zu: seq=%u value=%d", i, results[i].seq,
                    results[i].value);
            return -1;
        }
    }

    LOG_INF("CounterStream: received %zu responses", result_count);
    if (result_count != count) {
        LOG_ERR("CounterStream count mismatch: expected %u, got %zu", count, result_count);
        return -1;
    }

    LOG_INF("CounterStream test PASSED");
    return 0;
}

static int test_counter_upload(void)
{
    LOG_INF("=== CounterUpload Test ===");

    const uint32_t count = 5;
    blerpc_CounterUploadRequest messages[5];
    for (uint32_t i = 0; i < count; i++) {
        messages[i] = (blerpc_CounterUploadRequest)blerpc_CounterUploadRequest_init_zero;
        messages[i].seq = i;
        messages[i].value = (int32_t)(i * 10);
    }

    blerpc_CounterUploadResponse resp;
    if (blerpc_counter_upload(messages, count, &resp) != 0) {
        LOG_ERR("CounterUpload failed");
        return -1;
    }

    LOG_INF("CounterUpload response: received_count=%u", resp.received_count);

    if (resp.received_count != count) {
        LOG_ERR("CounterUpload count mismatch: expected %u, got %u", count, resp.received_count);
        return -1;
    }

    LOG_INF("CounterUpload test PASSED");
    return 0;
}

/* ── Main ────────────────────────────────────────────────────────────── */

int main(void)
{
    int err;

    LOG_INF("blerpc central starting");

#ifdef CONFIG_BLERPC_ENCRYPTION
    /* mbedTLS on NCS defaults mbedtls_calloc to a stub returning NULL.
     * Use Zephyr's k_calloc/k_free backed by CONFIG_HEAP_MEM_POOL_SIZE. */
    mbedtls_platform_set_calloc_free(k_calloc, k_free);
#endif

    err = bt_enable(NULL);
    if (err) {
        LOG_ERR("Bluetooth init failed (err %d)", err);
        return err;
    }
    LOG_INF("Bluetooth initialized");

    ble_central_init(on_response, on_error);

    err = ble_central_connect();
    if (err) {
        LOG_ERR("Connect failed (err %d)", err);
        return err;
    }

    LOG_INF("MTU: %u", ble_central_get_mtu());

    /* Request capabilities from peripheral */
    err = ble_central_request_capabilities();
    if (err) {
        LOG_WRN("Capabilities request failed (err %d), continuing without limits", err);
    } else {
        LOG_INF("Peripheral capabilities: max_request=%u, max_response=%u",
                ble_central_get_max_request_payload_size(),
                ble_central_get_max_response_payload_size());
    }

    /* Key exchange. When encryption is compiled in it is REQUIRED (fail closed):
     * the peripheral must advertise encryption and its pinned identity must
     * verify, otherwise we refuse to proceed — never fall back to plaintext. */
#ifdef CONFIG_BLERPC_ENCRYPTION
    uint16_t cap_flags = ble_central_get_capability_flags();
    if (!(cap_flags & CAPABILITY_FLAG_ENCRYPTION_SUPPORTED)) {
        LOG_ERR("Peripheral does not offer encryption — refusing (encryption required)");
        return -1;
    }
    LOG_INF("Performing key exchange...");
    err = ble_central_perform_key_exchange();
    if (err) {
        LOG_ERR("Key exchange / peer identity verification failed (err %d) — aborting", err);
        return -1;
    }
    LOG_INF("E2E encryption active (peer identity verified)");
#endif

    /* Allow subscription to settle */
    k_sleep(K_MSEC(200));

    /* Run tests */
    int failures = 0;

    if (test_echo() != 0) {
        failures++;
    }

    k_sleep(K_MSEC(100));

    if (test_flash_read(MAX_TEST_PAYLOAD) != 0) {
        failures++;
    }

    k_sleep(K_MSEC(100));

    if (test_throughput() != 0) {
        failures++;
    }

    k_sleep(K_MSEC(100));

    if (test_data_write(MAX_TEST_PAYLOAD) != 0) {
        failures++;
    }

    k_sleep(K_MSEC(100));

    if (test_write_throughput() != 0) {
        failures++;
    }

    k_sleep(K_MSEC(100));

    if (test_counter_stream() != 0) {
        failures++;
    }

    k_sleep(K_MSEC(100));

    if (test_counter_upload() != 0) {
        failures++;
    }

    LOG_INF("===========================");
    if (failures == 0) {
        LOG_INF("All tests PASSED");
    } else {
        LOG_ERR("%d test(s) FAILED", failures);
    }

    return 0;
}
```

## src/ble_central.c
```c
#include "ble_central.h"
#include <blerpc_protocol/container.h>

#ifdef CONFIG_BLERPC_ENCRYPTION
#include <blerpc_protocol/crypto.h>
#include <mbedtls/platform_util.h>
#include <psa/crypto.h>
#include <string.h>
#endif

#include <zephyr/kernel.h>
#include <zephyr/bluetooth/bluetooth.h>
#include <zephyr/bluetooth/conn.h>
#include <zephyr/bluetooth/gatt.h>
#include <zephyr/bluetooth/uuid.h>
#include <zephyr/logging/log.h>

LOG_MODULE_REGISTER(ble_central, LOG_LEVEL_INF);

/* Timeout for BLE operations (scan, discovery, etc.) */
#define BLE_OP_TIMEOUT K_SECONDS(10)

/* UUIDs */
static struct bt_uuid_128 blerpc_svc_uuid = BT_UUID_INIT_128(BLERPC_SERVICE_UUID);
static struct bt_uuid_128 blerpc_char_uuid = BT_UUID_INIT_128(BLERPC_CHAR_UUID);

/* Connection state */
static struct bt_conn *current_conn;
static uint16_t char_value_handle;
static struct bt_gatt_subscribe_params subscribe_params;

/* Container assembler for incoming notifications */
static struct container_assembler assembler;

/* Callbacks */
static ble_central_response_cb_t response_cb;
static ble_central_error_cb_t error_cb;
static ble_central_stream_end_cb_t stream_end_cb;

/* Capabilities */
static uint16_t max_request_payload_size;
static uint16_t max_response_payload_size;
static uint16_t capability_flags;
static K_SEM_DEFINE(caps_sem, 0, 1);

#ifdef CONFIG_BLERPC_ENCRYPTION
/* Encryption state */
static struct blerpc_crypto_session crypto_session;
static bool encryption_active;
static K_SEM_DEFINE(kx_sem, 0, 1);
static uint8_t kx_response_buf[BLERPC_STEP2_SIZE + CONTAINER_CONTROL_HEADER_SIZE];
static size_t kx_response_len;
#endif

/* Synchronization semaphores */
static K_SEM_DEFINE(connect_sem, 0, 1);
static K_SEM_DEFINE(discover_sem, 0, 1);
static K_SEM_DEFINE(mtu_sem, 0, 1);

/* ── Scan callbacks ──────────────────────────────────────────────────── */

static void device_found(const bt_addr_le_t *addr, int8_t rssi, uint8_t type,
                         struct net_buf_simple *ad)
{
    /* Only look at connectable advertisements and scan responses */
    if (type != BT_GAP_ADV_TYPE_ADV_IND && type != BT_GAP_ADV_TYPE_ADV_DIRECT_IND &&
        type != BT_GAP_ADV_TYPE_SCAN_RSP) {
        return;
    }

    /* Check advertisement data for blerpc service UUID */
    struct net_buf_simple_state state;
    net_buf_simple_save(ad, &state);

    /* The service UUID alone is not a unique filter — other products advertise it
     * too — so CONFIG_BLERPC_PEER_DEVICE_NAME can narrow it further. The UUID and
     * the name typically arrive in separate packets (either order: this firmware
     * puts the UUID in ADV_IND and the name in SCAN_RSP, other peripherals do the
     * reverse), so remember the address that advertised the UUID and let a later
     * packet from that same address supply the name. The cache holds one address,
     * so with several bleRPC peripherals in range a match can take an extra
     * advertising cycle — scanning is continuous, so it still converges. */
    static bt_addr_le_t uuid_addr;
    static bool uuid_addr_valid;

    const char *want_name = CONFIG_BLERPC_PEER_DEVICE_NAME;
    const size_t want_name_len = sizeof(CONFIG_BLERPC_PEER_DEVICE_NAME) - 1;

    bool has_uuid = false;
    bool has_name = false;

    while (ad->len > 1) {
        uint8_t field_len = net_buf_simple_pull_u8(ad);
        if (field_len == 0 || field_len > ad->len) {
            break;
        }
        uint8_t field_type = net_buf_simple_pull_u8(ad);
        field_len--; /* Exclude type byte */

        if ((field_type == BT_DATA_UUID128_ALL || field_type == BT_DATA_UUID128_SOME) &&
            field_len == 16 && memcmp(ad->data, blerpc_svc_uuid.val, 16) == 0) {
            has_uuid = true;
        } else if ((field_type == BT_DATA_NAME_COMPLETE || field_type == BT_DATA_NAME_SHORTENED) &&
                   want_name_len != 0 && field_len == want_name_len &&
                   memcmp(ad->data, want_name, want_name_len) == 0) {
            has_name = true;
        }

        net_buf_simple_pull(ad, field_len);
    }

    net_buf_simple_restore(ad, &state);

    if (want_name_len == 0) {
        if (!has_uuid) {
            return;
        }
    } else {
        if (has_uuid) {
            bt_addr_le_copy(&uuid_addr, addr);
            uuid_addr_valid = true;
        }
        bool uuid_ok = has_uuid || (uuid_addr_valid && bt_addr_le_eq(&uuid_addr, addr));
        if (!uuid_ok || !has_name) {
            return;
        }
    }

    char addr_str[BT_ADDR_LE_STR_LEN];
    bt_addr_le_to_str(addr, addr_str, sizeof(addr_str));
    LOG_INF("Found blerpc device: %s (RSSI %d)", addr_str, rssi);

    int err = bt_le_scan_stop();
    if (err) {
        LOG_ERR("Scan stop failed (err %d)", err);
        return;
    }

    struct bt_conn_le_create_param create_param = BT_CONN_LE_CREATE_PARAM_INIT(
        BT_CONN_LE_OPT_NONE, BT_GAP_SCAN_FAST_INTERVAL, BT_GAP_SCAN_FAST_WINDOW);

    /* Pin the interval to 15 ms (12 * 1.25 ms) rather than offering a 15-30 ms
     * window: a central given a range picks the power-efficient end, so a window
     * would run the link at 30 ms until the peripheral's own parameter update
     * request arrives 5 s later. */
    struct bt_le_conn_param conn_param = BT_LE_CONN_PARAM_INIT(12, 12, 0, 100);

    err = bt_conn_le_create(addr, &create_param, &conn_param, &current_conn);
    if (err) {
        LOG_ERR("Create connection failed (err %d)", err);
    }
}

/* ── GATT discovery ──────────────────────────────────────────────────── */

static struct bt_gatt_discover_params discover_params;
static uint16_t svc_start_handle;
static uint16_t svc_end_handle;

static uint8_t discover_desc_cb(struct bt_conn *conn, const struct bt_gatt_attr *attr,
                                struct bt_gatt_discover_params *params)
{
    if (!attr) {
        LOG_INF("Descriptor discovery complete");
        k_sem_give(&discover_sem);
        return BT_GATT_ITER_STOP;
    }

    LOG_INF("Descriptor found: handle %u", attr->handle);

    /* Subscribe for notifications */
    subscribe_params.notify = NULL; /* Set later */
    subscribe_params.value_handle = char_value_handle;
    subscribe_params.ccc_handle = attr->handle;
    subscribe_params.value = BT_GATT_CCC_NOTIFY;

    k_sem_give(&discover_sem);
    return BT_GATT_ITER_STOP;
}

static uint8_t discover_char_cb(struct bt_conn *conn, const struct bt_gatt_attr *attr,
                                struct bt_gatt_discover_params *params)
{
    if (!attr) {
        LOG_ERR("Characteristic not found");
        k_sem_give(&discover_sem);
        return BT_GATT_ITER_STOP;
    }

    struct bt_gatt_chrc *chrc = (struct bt_gatt_chrc *)attr->user_data;
    char_value_handle = chrc->value_handle;
    LOG_INF("Characteristic found: value_handle %u", char_value_handle);

    k_sem_give(&discover_sem);
    return BT_GATT_ITER_STOP;
}

static uint8_t discover_svc_cb(struct bt_conn *conn, const struct bt_gatt_attr *attr,
                               struct bt_gatt_discover_params *params)
{
    if (!attr) {
        LOG_ERR("Service not found");
        k_sem_give(&discover_sem);
        return BT_GATT_ITER_STOP;
    }

    struct bt_gatt_service_val *svc = (struct bt_gatt_service_val *)attr->user_data;
    svc_start_handle = attr->handle;
    svc_end_handle = svc->end_handle;
    LOG_INF("Service found: handles %u-%u", svc_start_handle, svc_end_handle);

    k_sem_give(&discover_sem);
    return BT_GATT_ITER_STOP;
}

static int gatt_discover(void)
{
    int err;

    /* Phase 1: Discover primary service */
    memset(&discover_params, 0, sizeof(discover_params));
    discover_params.uuid = &blerpc_svc_uuid.uuid;
    discover_params.func = discover_svc_cb;
    discover_params.start_handle = BT_ATT_FIRST_ATTRIBUTE_HANDLE;
    discover_params.end_handle = BT_ATT_LAST_ATTRIBUTE_HANDLE;
    discover_params.type = BT_GATT_DISCOVER_PRIMARY;

    err = bt_gatt_discover(current_conn, &discover_params);
    if (err) {
        LOG_ERR("Service discover failed (err %d)", err);
        return err;
    }
    if (k_sem_take(&discover_sem, BLE_OP_TIMEOUT) != 0) {
        LOG_ERR("Service discovery timed out");
        return -ETIMEDOUT;
    }

    if (svc_start_handle == 0) {
        LOG_ERR("Service not found");
        return -ENOENT;
    }

    /* Phase 2: Discover characteristic */
    memset(&discover_params, 0, sizeof(discover_params));
    discover_params.uuid = &blerpc_char_uuid.uuid;
    discover_params.func = discover_char_cb;
    discover_params.start_handle = svc_start_handle;
    discover_params.end_handle = svc_end_handle;
    discover_params.type = BT_GATT_DISCOVER_CHARACTERISTIC;

    err = bt_gatt_discover(current_conn, &discover_params);
    if (err) {
        LOG_ERR("Char discover failed (err %d)", err);
        return err;
    }
    if (k_sem_take(&discover_sem, BLE_OP_TIMEOUT) != 0) {
        LOG_ERR("Characteristic discovery timed out");
        return -ETIMEDOUT;
    }

    if (char_value_handle == 0) {
        LOG_ERR("Characteristic not found");
        return -ENOENT;
    }

    /* Phase 3: Discover CCC descriptor */
    memset(&discover_params, 0, sizeof(discover_params));
    discover_params.uuid = BT_UUID_GATT_CCC;
    discover_params.func = discover_desc_cb;
    discover_params.start_handle = char_value_handle + 1;
    discover_params.end_handle = svc_end_handle;
    discover_params.type = BT_GATT_DISCOVER_DESCRIPTOR;

    err = bt_gatt_discover(current_conn, &discover_params);
    if (err) {
        LOG_ERR("Descriptor discover failed (err %d)", err);
        return err;
    }
    if (k_sem_take(&discover_sem, BLE_OP_TIMEOUT) != 0) {
        LOG_ERR("Descriptor discovery timed out");
        return -ETIMEDOUT;
    }

    return 0;
}

/* ── Notification handler ────────────────────────────────────────────── */

static uint8_t notify_handler(struct bt_conn *conn, struct bt_gatt_subscribe_params *params,
                              const void *data, uint16_t length)
{
    if (!data) {
        LOG_INF("Notifications disabled");
        params->value_handle = 0;
        return BT_GATT_ITER_STOP;
    }

    LOG_DBG("Notification: %u bytes", length);

    struct container_header hdr;
    if (container_parse_header(data, length, &hdr) != 0) {
        LOG_ERR("Container parse failed");
        return BT_GATT_ITER_CONTINUE;
    }

    /* Handle control containers before assembler */
    if (hdr.type == CONTAINER_TYPE_CONTROL) {
        if (hdr.control_cmd == CONTROL_CMD_STREAM_END_P2C) {
            if (stream_end_cb) {
                stream_end_cb();
            }
        } else if (hdr.control_cmd == CONTROL_CMD_CAPABILITIES && hdr.payload_len >= 4) {
            max_request_payload_size = (uint16_t)(hdr.payload[0] | (hdr.payload[1] << 8));
            max_response_payload_size = (uint16_t)(hdr.payload[2] | (hdr.payload[3] << 8));
            capability_flags = 0;
            if (hdr.payload_len >= 6) {
                capability_flags = (uint16_t)hdr.payload[4] | ((uint16_t)hdr.payload[5] << 8);
            }
            k_sem_give(&caps_sem);
        } else if (hdr.control_cmd == CONTROL_CMD_ERROR && hdr.payload_len >= 1) {
            if (error_cb) {
                error_cb(hdr.payload[0]);
            }
#ifdef CONFIG_BLERPC_ENCRYPTION
        } else if (hdr.control_cmd == CONTROL_CMD_KEY_EXCHANGE) {
            /* Store raw notification for key exchange processing */
            if (length <= sizeof(kx_response_buf)) {
                memcpy(kx_response_buf, data, length);
                kx_response_len = length;
                k_sem_give(&kx_sem);
            }
#endif
        }
        return BT_GATT_ITER_CONTINUE;
    }

    int rc = container_assembler_feed(&assembler, &hdr);
    if (rc == 1) {
        /* Assembly complete */
#ifdef CONFIG_BLERPC_ENCRYPTION
        if (encryption_active) {
            static uint8_t decrypted[CONFIG_BLERPC_PROTOCOL_ASSEMBLER_BUF_SIZE];
            size_t decrypted_len;
            if (blerpc_crypto_session_decrypt(&crypto_session, decrypted, sizeof(decrypted),
                                              &decrypted_len, assembler.buf,
                                              assembler.total_length) != 0) {
                LOG_ERR("Response decryption failed");
                container_assembler_init(&assembler);
                return BT_GATT_ITER_CONTINUE;
            }
            if (response_cb) {
                response_cb(decrypted, decrypted_len);
            }
        } else {
#endif
            if (response_cb) {
                response_cb(assembler.buf, assembler.total_length);
            }
#ifdef CONFIG_BLERPC_ENCRYPTION
        }
#endif
        container_assembler_init(&assembler);
    } else if (rc < 0) {
        LOG_ERR("Assembler error");
        container_assembler_init(&assembler);
    }

    return BT_GATT_ITER_CONTINUE;
}

/* ── Connection callbacks ────────────────────────────────────────────── */

/* Connection interval is in 1.25 ms units, supervision timeout in 10 ms units. */
#define CONN_INT_MS_INT(units) ((units) * 125U / 100U)
#define CONN_INT_MS_FRAC(units) ((units) * 125U % 100U)

static void connected_cb(struct bt_conn *conn, uint8_t err)
{
    if (err) {
        LOG_ERR("Connection failed (err %u)", err);
        if (current_conn) {
            bt_conn_unref(current_conn);
            current_conn = NULL;
        }
        k_sem_give(&connect_sem);
        return;
    }

    LOG_INF("Connected");

    struct bt_conn_info info;
    if (bt_conn_get_info(conn, &info) == 0) {
        LOG_INF("Conn params (initial): interval %u (%u.%02u ms), latency %u, timeout %u ms",
                info.le.interval, CONN_INT_MS_INT(info.le.interval),
                CONN_INT_MS_FRAC(info.le.interval), info.le.latency, info.le.timeout * 10U);
    }

    k_sem_give(&connect_sem);
}

static void disconnected_cb(struct bt_conn *conn, uint8_t reason)
{
    LOG_INF("Disconnected (reason %u)", reason);
    if (current_conn) {
        bt_conn_unref(current_conn);
        current_conn = NULL;
    }
#ifdef CONFIG_BLERPC_ENCRYPTION
    encryption_active = false;
    mbedtls_platform_zeroize(&crypto_session, sizeof(crypto_session));
#endif
}

static bool le_param_req_cb(struct bt_conn *conn, struct bt_le_conn_param *param)
{
    LOG_INF("Conn params requested: interval %u-%u (%u.%02u-%u.%02u ms), latency %u, timeout %u ms",
            param->interval_min, param->interval_max, CONN_INT_MS_INT(param->interval_min),
            CONN_INT_MS_FRAC(param->interval_min), CONN_INT_MS_INT(param->interval_max),
            CONN_INT_MS_FRAC(param->interval_max), param->latency, param->timeout * 10U);
    return true;
}

static void le_param_updated_cb(struct bt_conn *conn, uint16_t interval, uint16_t latency,
                                uint16_t timeout)
{
    LOG_INF("Conn params updated: interval %u (%u.%02u ms), latency %u, timeout %u ms", interval,
            CONN_INT_MS_INT(interval), CONN_INT_MS_FRAC(interval), latency, timeout * 10U);
}

BT_CONN_CB_DEFINE(conn_callbacks) = {
    .connected = connected_cb,
    .disconnected = disconnected_cb,
    .le_param_req = le_param_req_cb,
    .le_param_updated = le_param_updated_cb,
};

/* ── MTU exchange ────────────────────────────────────────────────────── */

static struct bt_gatt_exchange_params mtu_exchange_params;

static void mtu_exchange_cb(struct bt_conn *conn, uint8_t err,
                            struct bt_gatt_exchange_params *params)
{
    if (err) {
        LOG_ERR("MTU exchange failed (err %u)", err);
    } else {
        LOG_INF("MTU exchanged: %u", bt_gatt_get_mtu(conn));
    }
    k_sem_give(&mtu_sem);
}

/* ── Public API ──────────────────────────────────────────────────────── */

void ble_central_init(ble_central_response_cb_t resp_cb, ble_central_error_cb_t err_cb)
{
    response_cb = resp_cb;
    error_cb = err_cb;
    container_assembler_init(&assembler);
}

int ble_central_connect(void)
{
    int err;

    LOG_INF("Scanning for blerpc peripheral...");

    err = bt_le_scan_start(BT_LE_SCAN_ACTIVE, device_found);
    if (err) {
        LOG_ERR("Scan start failed (err %d)", err);
        return err;
    }

    /* Wait for connection */
    if (k_sem_take(&connect_sem, BLE_OP_TIMEOUT) != 0) {
        LOG_ERR("Connection timed out");
        bt_le_scan_stop();
        return -ETIMEDOUT;
    }

    if (!current_conn) {
        LOG_ERR("Connection failed");
        return -ENOTCONN;
    }

    /* Request data length update */
    struct bt_conn_le_data_len_param dl_param = {
        .tx_max_len = 251,
        .tx_max_time = 2120,
    };
    err = bt_conn_le_data_len_update(current_conn, &dl_param);
    if (err) {
        LOG_WRN("Data length update failed (err %d), continuing", err);
    }

    /* Exchange MTU */
    mtu_exchange_params.func = mtu_exchange_cb;
    err = bt_gatt_exchange_mtu(current_conn, &mtu_exchange_params);
    if (err) {
        LOG_ERR("MTU exchange request failed (err %d)", err);
    } else {
        k_sem_take(&mtu_sem, K_SECONDS(5));
    }

    /* GATT discovery */
    err = gatt_discover();
    if (err) {
        return err;
    }

    /* Subscribe for notifications */
    subscribe_params.notify = notify_handler;
    err = bt_gatt_subscribe(current_conn, &subscribe_params);
    if (err) {
        LOG_ERR("Subscribe failed (err %d)", err);
        return err;
    }

    LOG_INF("Subscribed to notifications");
    return 0;
}

int ble_central_write(const uint8_t *data, size_t len)
{
    if (!current_conn) {
        return -ENOTCONN;
    }

    return bt_gatt_write_without_response(current_conn, char_value_handle, data, len, false);
}

int ble_central_encrypt_payload(const uint8_t *plaintext, size_t plaintext_len, uint8_t *out,
                                size_t out_size, size_t *out_len)
{
#ifdef CONFIG_BLERPC_ENCRYPTION
    if (encryption_active) {
        return blerpc_crypto_session_encrypt(&crypto_session, out, out_size, out_len, plaintext,
                                             plaintext_len);
    }
#endif
    if (plaintext_len > out_size) {
        return -ENOMEM;
    }
    memcpy(out, plaintext, plaintext_len);
    *out_len = plaintext_len;
    return 0;
}

uint16_t ble_central_get_mtu(void)
{
    if (current_conn) {
        return bt_gatt_get_mtu(current_conn);
    }
    return 23;
}

int ble_central_request_capabilities(void)
{
    uint8_t ctrl_buf[8];
    struct container_header ctrl = {
        .transaction_id = 0,
        .sequence_number = 0,
        .type = CONTAINER_TYPE_CONTROL,
        .control_cmd = CONTROL_CMD_CAPABILITIES,
        .payload_len = 0,
    };
    ctrl.payload = NULL;
    int n = container_serialize(&ctrl, ctrl_buf, sizeof(ctrl_buf));
    if (n < 0) {
        return -EINVAL;
    }

    int err = ble_central_write(ctrl_buf, (size_t)n);
    if (err) {
        return err;
    }

    /* Wait up to 1 second for response */
    err = k_sem_take(&caps_sem, K_SECONDS(1));
    if (err) {
        return -ETIMEDOUT;
    }

    return 0;
}

uint16_t ble_central_get_max_request_payload_size(void)
{
    return max_request_payload_size;
}

uint16_t ble_central_get_max_response_payload_size(void)
{
    return max_response_payload_size;
}

uint16_t ble_central_get_capability_flags(void)
{
    return capability_flags;
}

#ifdef CONFIG_BLERPC_ENCRYPTION

static int kx_send_cb(const uint8_t *payload, size_t len, void *ctx)
{
    (void)ctx;
    uint8_t ctrl_buf[BLERPC_STEP2_SIZE + CONTAINER_CONTROL_HEADER_SIZE];
    struct container_header ctrl = {
        .transaction_id = 0,
        .sequence_number = 0,
        .type = CONTAINER_TYPE_CONTROL,
        .control_cmd = CONTROL_CMD_KEY_EXCHANGE,
        .payload_len = len,
        .payload = payload,
    };
    int n = container_serialize(&ctrl, ctrl_buf, sizeof(ctrl_buf));
    if (n < 0) {
        return -1;
    }

    k_sem_reset(&kx_sem);
    return ble_central_write(ctrl_buf, (size_t)n);
}

static int kx_recv_cb(uint8_t *buf, size_t buf_size, size_t *out_len, void *ctx)
{
    (void)ctx;
    int err = k_sem_take(&kx_sem, K_SECONDS(5));
    if (err) {
        return -1;
    }

    struct container_header hdr;
    if (container_parse_header(kx_response_buf, kx_response_len, &hdr) != 0) {
        return -1;
    }

    if (hdr.payload_len > buf_size) {
        return -1;
    }
    memcpy(buf, hdr.payload, hdr.payload_len);
    *out_len = hdr.payload_len;
    return 0;
}

/* Fail closed at build time: pinning the peripheral's identity key is what makes
 * the handshake MitM-resistant, so a 64-hex-char peer key MUST be configured. */
BUILD_ASSERT(sizeof(CONFIG_BLERPC_PEER_ED25519_PUBLIC_KEY) == 64 + 1,
             "CONFIG_BLERPC_PEER_ED25519_PUBLIC_KEY must be 64 hex chars "
             "(the peripheral's Ed25519 identity public key); see keys.conf");

static int hex_nibble(char c)
{
    if (c >= '0' && c <= '9') {
        return c - '0';
    }
    if (c >= 'a' && c <= 'f') {
        return c - 'a' + 10;
    }
    if (c >= 'A' && c <= 'F') {
        return c - 'A' + 10;
    }
    return -1;
}

static int hex_to_bytes(const char *hex, uint8_t *out, size_t out_len)
{
    for (size_t i = 0; i < out_len; i++) {
        int hi = hex_nibble(hex[i * 2]);
        int lo = hex_nibble(hex[i * 2 + 1]);
        if (hi < 0 || lo < 0) {
            return -1;
        }
        out[i] = (uint8_t)((hi << 4) | lo);
    }
    return 0;
}

static bool verify_peer_identity_cb(const uint8_t ed25519_pubkey[BLERPC_ED25519_PUBKEY_SIZE],
                                    void *ctx)
{
    const uint8_t *expected_id = (const uint8_t *)ctx;
    return memcmp(ed25519_pubkey, expected_id, BLERPC_ED25519_PUBKEY_SIZE) == 0;
}

int ble_central_perform_key_exchange(void)
{
    /* PSA Crypto must be initialized before any PSA operations */
    psa_status_t psa_rc = psa_crypto_init();
    if (psa_rc != PSA_SUCCESS) {
        LOG_ERR("psa_crypto_init failed: %d", (int)psa_rc);
        return -EIO;
    }

    /* Parse the pinned peripheral identity key */
    uint8_t expected_id[BLERPC_ED25519_PUBKEY_SIZE];
    if (hex_to_bytes(CONFIG_BLERPC_PEER_ED25519_PUBLIC_KEY, expected_id, sizeof(expected_id)) !=
        0) {
        LOG_ERR("Invalid hex in CONFIG_BLERPC_PEER_ED25519_PUBLIC_KEY");
        return -EINVAL;
    }

    /* Fail-closed identity pinning: the signed handshake alone does not bind the
     * identity key, so the library verifies the peripheral's Ed25519 identity
     * against the configured peer mid-handshake and aborts on mismatch (possible
     * MitM) before any session is established. */
    int rc = blerpc_central_perform_key_exchange(kx_send_cb, kx_recv_cb, NULL, &crypto_session,
                                                 verify_peer_identity_cb, expected_id,
                                                 /*pin_identity=*/true, NULL);
    if (rc != 0) {
        LOG_ERR("Key exchange failed or peer identity rejected: %d", rc);
        return -EACCES;
    }

    encryption_active = true;
    LOG_INF("E2E encryption established (peer identity verified)");
    return 0;
}
#else
int ble_central_perform_key_exchange(void)
{
    LOG_ERR("Encryption support not compiled in (CONFIG_BLERPC_ENCRYPTION)");
    return -ENOTSUP;
}
#endif /* CONFIG_BLERPC_ENCRYPTION */

bool ble_central_is_encrypted(void)
{
#ifdef CONFIG_BLERPC_ENCRYPTION
    return encryption_active;
#else
    return false;
#endif
}

void ble_central_set_stream_end_cb(ble_central_stream_end_cb_t cb)
{
    stream_end_cb = cb;
}

int ble_central_send_stream_end_c2p(void)
{
    uint8_t ctrl_buf[8];
    struct container_header ctrl = {
        .transaction_id = 0,
        .sequence_number = 0,
        .type = CONTAINER_TYPE_CONTROL,
        .control_cmd = CONTROL_CMD_STREAM_END_C2P,
        .payload_len = 0,
    };
    ctrl.payload = NULL;
    int n = container_serialize(&ctrl, ctrl_buf, sizeof(ctrl_buf));
    if (n < 0) {
        return -EINVAL;
    }
    return ble_central_write(ctrl_buf, (size_t)n);
}
```

## src/ble_central.h
```c
#ifndef BLERPC_BLE_CENTRAL_H
#define BLERPC_BLE_CENTRAL_H

#include <stdbool.h>
#include <stdint.h>
#include <stddef.h>

#ifdef __cplusplus
extern "C" {
#endif

/* blerpc Service UUID: 12340001-0000-1000-8000-00805f9b34fb */
#define BLERPC_SERVICE_UUID BT_UUID_128_ENCODE(0x12340001, 0x0000, 0x1000, 0x8000, 0x00805f9b34fb)

/* blerpc Characteristic UUID: 12340002-0000-1000-8000-00805f9b34fb */
#define BLERPC_CHAR_UUID BT_UUID_128_ENCODE(0x12340002, 0x0000, 0x1000, 0x8000, 0x00805f9b34fb)

/**
 * Callback for received RPC response data (assembled payload).
 */
typedef void (*ble_central_response_cb_t)(const uint8_t *data, size_t len);

/**
 * Callback for received error control containers.
 */
typedef void (*ble_central_error_cb_t)(uint8_t error_code);

/**
 * Callback for STREAM_END_P2C control container.
 */
typedef void (*ble_central_stream_end_cb_t)(void);

/**
 * Initialize the BLE central module.
 * @param resp_cb  Callback invoked when a complete response is assembled
 * @param err_cb   Callback invoked when an ERROR control container is received
 */
void ble_central_init(ble_central_response_cb_t resp_cb, ble_central_error_cb_t err_cb);

/**
 * Set callback for STREAM_END_P2C reception.
 */
void ble_central_set_stream_end_cb(ble_central_stream_end_cb_t cb);

/**
 * Send a STREAM_END_C2P control container to peripheral.
 * @return 0 on success, negative on error
 */
int ble_central_send_stream_end_c2p(void);

/**
 * Scan for and connect to a device advertising the blerpc service UUID.
 * Uses passive scan. Blocks until connected and GATT discovery + subscription complete.
 * @return 0 on success, negative on error
 */
int ble_central_connect(void);

/**
 * Send data to the peripheral (write without response).
 * @return 0 on success, negative on error
 */
int ble_central_write(const uint8_t *data, size_t len);

/**
 * Get the current connection MTU.
 */
uint16_t ble_central_get_mtu(void);

/**
 * Request capabilities from the peripheral.
 * Blocks until response received or timeout.
 * @return 0 on success, negative on error/timeout
 */
int ble_central_request_capabilities(void);

/**
 * Get peripheral's max request payload size (0 if unknown).
 */
uint16_t ble_central_get_max_request_payload_size(void);

/**
 * Get peripheral's max response payload size (0 if unknown).
 */
uint16_t ble_central_get_max_response_payload_size(void);

/**
 * Get peripheral's capability flags (0 if unknown).
 */
uint16_t ble_central_get_capability_flags(void);

/**
 * Perform the 4-step key exchange handshake with the peripheral.
 * Requires CONFIG_BLERPC_ENCRYPTION to be enabled.
 * Must be called after capabilities have been received and peripheral
 * advertises CAPABILITY_FLAG_ENCRYPTION_SUPPORTED.
 * Blocks until key exchange completes or fails.
 * @return 0 on success, negative on error
 */
int ble_central_perform_key_exchange(void);

/**
 * Check whether E2E encryption is currently active.
 * @return true if encryption is active
 */
bool ble_central_is_encrypted(void);

/**
 * Encrypt a payload for sending to the peripheral.
 * If encryption is not active, copies plaintext to out unchanged.
 * @return 0 on success, negative on error
 */
int ble_central_encrypt_payload(const uint8_t *plaintext, size_t plaintext_len, uint8_t *out,
                                size_t out_size, size_t *out_len);

#ifdef __cplusplus
}
#endif

#endif /* BLERPC_BLE_CENTRAL_H */
```

## src/blerpc.pb.c
```c
../../peripheral_fw/src/blerpc.pb.c
```

## src/blerpc.pb.h
```c
../../peripheral_fw/src/blerpc.pb.h
```

## src/command.c
```c
../../peripheral_fw/src/command.c
```

## src/command.h
```c
../../peripheral_fw/src/command.h
```

## src/container.c
```c
../../peripheral_fw/src/container.c
```

## src/container.h
```c
../../peripheral_fw/src/container.h
```
