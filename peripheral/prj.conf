## CMakeLists.txt
```
cmake_minimum_required(VERSION 3.20.0)

# blerpc-protocol library (container + command layers)
set(BLERPC_PROTOCOL_DIR ${CMAKE_CURRENT_SOURCE_DIR}/../../blerpc-protocol/c
    CACHE PATH "Path to blerpc-protocol C library")
list(APPEND ZEPHYR_EXTRA_MODULES ${BLERPC_PROTOCOL_DIR})

find_package(Zephyr REQUIRED HINTS $ENV{ZEPHYR_BASE})
project(blerpc_peripheral)

# nanopb
list(APPEND CMAKE_MODULE_PATH ${ZEPHYR_BASE}/../modules/lib/nanopb/extra)
include(FindNanopb)

target_sources(app PRIVATE
    src/main.c
    src/ble_service.c
    src/handlers.c
    src/generated_handlers.c
    src/blerpc.pb.c
)

target_include_directories(app PRIVATE
    src
)
```

## Kconfig
```
source "Kconfig.zephyr"

config BLERPC_TIMEOUT_MS
	int "Default timeout in milliseconds"
	default 100
	help
	  Default timeout value reported to Central via timeout control container.

config BLERPC_MAX_RESPONSE_PAYLOAD_SIZE
	int "Maximum response payload size"
	default 65535
	help
	  Maximum response payload size reported to Central via capabilities
	  control container. The streaming encoder has no buffer limit, so this
	  defaults to the protocol maximum (65535).

config BLERPC_WORK_STACK_SIZE
	int "Work queue stack size"
	default MAIN_STACK_SIZE
	help
	  Stack size for the blerpc request processing work queue.
```

## prj.conf
```kconfig
# Bluetooth
CONFIG_BT=y
CONFIG_BT_PERIPHERAL=y
CONFIG_BT_DEVICE_NAME="blerpc"
CONFIG_BT_DEVICE_APPEARANCE=0

# MTU - request large MTU for throughput
CONFIG_BT_L2CAP_TX_MTU=247
CONFIG_BT_BUF_ACL_TX_SIZE=251
CONFIG_BT_BUF_ACL_RX_SIZE=251
# GATT
CONFIG_BT_GATT_DYNAMIC_DB=n

# TX buffers for large multi-container responses
CONFIG_BT_L2CAP_TX_BUF_COUNT=20
CONFIG_BT_BUF_ACL_TX_COUNT=20
CONFIG_BT_CONN_TX_MAX=20

# nanopb
CONFIG_NANOPB=y

# Flash
CONFIG_FLASH=y

# Logging
CONFIG_LOG=y
CONFIG_LOG_DEFAULT_LEVEL=3

# Console via UART
CONFIG_CONSOLE=y
CONFIG_UART_CONSOLE=y
CONFIG_SERIAL=y

# RTT logging backend
CONFIG_USE_SEGGER_RTT=y
CONFIG_LOG_BACKEND_RTT=y
CONFIG_LOG_BACKEND_RTT_MODE_DROP=y

# Connection parameters — request shortest interval for throughput
CONFIG_BT_PERIPHERAL_PREF_MIN_INT=12
CONFIG_BT_PERIPHERAL_PREF_MAX_INT=24
CONFIG_BT_PERIPHERAL_PREF_LATENCY=0
CONFIG_BT_PERIPHERAL_PREF_TIMEOUT=100

# blerpc specific
CONFIG_BLERPC_DEVICE_NAME="blerpc"
CONFIG_BLERPC_TIMEOUT_MS=100
CONFIG_BLERPC_PROTOCOL_ASSEMBLER_BUF_SIZE=12288

# Stack sizes
CONFIG_MAIN_STACK_SIZE=4096
CONFIG_SYSTEM_WORKQUEUE_STACK_SIZE=2048
CONFIG_BT_RX_STACK_SIZE=4096
```

## boards/xg22_ek2710a.conf
```kconfig
# EFR32xG22E: 32 KB RAM
# blerpc assembler buffer (small — echo/flash_read requests are tiny)
CONFIG_BLERPC_PROTOCOL_ASSEMBLER_BUF_SIZE=256

# Fewer TX buffers (1 connection only)
CONFIG_BT_L2CAP_TX_BUF_COUNT=3
CONFIG_BT_BUF_ACL_TX_COUNT=3
CONFIG_BT_CONN_TX_MAX=3
CONFIG_BT_BUF_ACL_RX_COUNT=3

# BT stack memory — minimum viable for Silicon Labs HCI
CONFIG_BT_SILABS_HCI_BUFFER_MEMORY=6144
CONFIG_COMMON_LIBC_MALLOC_ARENA_SIZE=7168
CONFIG_MAIN_STACK_SIZE=1536
CONFIG_BLERPC_WORK_STACK_SIZE=1536
CONFIG_SYSTEM_WORKQUEUE_STACK_SIZE=512
CONFIG_BT_RX_STACK_SIZE=768

# Disable flash to free RAM for RTT logging
CONFIG_FLASH=n

# Disable UART — use RTT console instead
CONFIG_UART_CONSOLE=n
CONFIG_SERIAL=n

# Minimal logging via RTT (printk → RTT console)
CONFIG_LOG=y
CONFIG_LOG_MODE_MINIMAL=y
CONFIG_CONSOLE=y
CONFIG_USE_SEGGER_RTT=y
CONFIG_RTT_CONSOLE=y
CONFIG_LOG_BACKEND_RTT=n
CONFIG_LOG_BACKEND_UART=n
CONFIG_SEGGER_RTT_BUFFER_SIZE_UP=128
```

## src/main.c
```c
#include <zephyr/kernel.h>
#include <zephyr/bluetooth/bluetooth.h>
#include <zephyr/logging/log.h>

#include "ble_service.h"
#include "handlers.h"

LOG_MODULE_REGISTER(main, LOG_LEVEL_INF);

int main(void)
{
    int err;

    err = bt_enable(NULL);
    if (err) {
        LOG_ERR("Bluetooth init failed (err %d)", err);
        return err;
    }
    LOG_INF("Bluetooth initialized");

    ble_service_init();
    handlers_stream_init();

    err = ble_service_start_advertising();
    if (err) {
        LOG_ERR("Advertising failed to start (err %d)", err);
        return err;
    }
    LOG_INF("Advertising started");

    return 0;
}
```

## src/ble_service.c
```c
#include "ble_service.h"
#include <blerpc_protocol/container.h>
#include <blerpc_protocol/command.h>
#include "handlers.h"

#include <zephyr/kernel.h>
#include <zephyr/bluetooth/bluetooth.h>
#include <zephyr/bluetooth/gap.h>
#include <zephyr/logging/log.h>
#include <pb_encode.h>

LOG_MODULE_REGISTER(ble_service, LOG_LEVEL_INF);

static struct bt_uuid_128 blerpc_svc_uuid = BT_UUID_INIT_128(BLERPC_SERVICE_UUID);
static struct bt_uuid_128 blerpc_char_uuid = BT_UUID_INIT_128(BLERPC_CHAR_UUID);

static struct bt_conn *current_conn;
static struct container_assembler assembler;
static ble_service_stream_end_cb_t stream_end_cb;
static uint8_t transaction_counter;

/* Work queue for async response processing */
static struct k_work_q blerpc_work_q;
static K_THREAD_STACK_DEFINE(blerpc_work_stack, CONFIG_BLERPC_WORK_STACK_SIZE);

struct request_work {
    struct k_work work;
    uint8_t transaction_id;
    size_t len;
    uint8_t data[CONFIG_BLERPC_PROTOCOL_ASSEMBLER_BUF_SIZE];
};

static struct request_work req_work;

/* ── Streaming container sender ──────────────────────────────────────── */

struct streaming_ctx {
    uint8_t transaction_id;
    uint16_t mtu;
    uint16_t total_length; /* total payload for FIRST container header */
    uint8_t buf[252];      /* one container at a time (max effective MTU) */
    uint8_t seq;
    uint8_t payload_used; /* payload bytes buffered in current container */
    bool first_sent;
    int error;
};

static int send_with_retry(const uint8_t *data, size_t len)
{
    int rc;
    for (int retries = 0; retries < 10; retries++) {
        rc = ble_service_notify(data, len);
        if (rc != -ENOMEM) {
            return rc;
        }
        k_sleep(K_MSEC(5));
    }
    LOG_ERR("Notify failed after retries: %d", rc);
    return rc;
}

static uint8_t streaming_header_size(struct streaming_ctx *ctx)
{
    return ctx->first_sent ? CONTAINER_SUBSEQUENT_HEADER_SIZE : CONTAINER_FIRST_HEADER_SIZE;
}

static uint8_t streaming_max_payload(struct streaming_ctx *ctx)
{
    return (uint8_t)((ctx->mtu - CONTAINER_ATT_OVERHEAD) - streaming_header_size(ctx));
}

static int streaming_flush_container(struct streaming_ctx *ctx)
{
    if (ctx->payload_used == 0) {
        return 0;
    }

    uint8_t hdr_size = streaming_header_size(ctx);

    /* Build container header in-place at buf[0..hdr_size-1] */
    ctx->buf[0] = ctx->transaction_id;
    ctx->buf[1] = ctx->seq;

    if (!ctx->first_sent) {
        ctx->buf[2] = ((CONTAINER_TYPE_FIRST & 0x03) << 6);
        ctx->buf[3] = (uint8_t)(ctx->total_length & 0xFF);
        ctx->buf[4] = (uint8_t)(ctx->total_length >> 8);
        ctx->buf[5] = ctx->payload_used;
    } else {
        ctx->buf[2] = ((CONTAINER_TYPE_SUBSEQUENT & 0x03) << 6);
        ctx->buf[3] = ctx->payload_used;
    }

    int rc = send_with_retry(ctx->buf, hdr_size + ctx->payload_used);
    if (rc < 0) {
        ctx->error = rc;
        return rc;
    }

    ctx->seq++;
    ctx->first_sent = true;
    ctx->payload_used = 0;
    return 0;
}

static int streaming_write(struct streaming_ctx *ctx, const uint8_t *data, size_t len)
{
    if (ctx->error) {
        return ctx->error;
    }

    while (len > 0) {
        uint8_t hdr_size = streaming_header_size(ctx);
        uint8_t max_payload = streaming_max_payload(ctx);
        uint8_t space = max_payload - ctx->payload_used;
        uint8_t n = (len < space) ? (uint8_t)len : space;

        memcpy(ctx->buf + hdr_size + ctx->payload_used, data, n);
        ctx->payload_used += n;
        data += n;
        len -= n;

        if (ctx->payload_used >= max_payload) {
            int rc = streaming_flush_container(ctx);
            if (rc < 0) {
                return rc;
            }
        }
    }
    return 0;
}

static bool streaming_pb_callback(pb_ostream_t *stream, const uint8_t *buf, size_t count)
{
    struct streaming_ctx *ctx = (struct streaming_ctx *)stream->state;
    return streaming_write(ctx, buf, count) == 0;
}

/* ── Request processing ──────────────────────────────────────────────── */

static void process_request(const uint8_t *data, size_t len, uint8_t transaction_id)
{
    /* Parse command */
    struct command_packet cmd;
    if (command_parse(data, len, &cmd) != 0) {
        LOG_ERR("Command parse failed");
        return;
    }

    if (cmd.cmd_type != COMMAND_TYPE_REQUEST) {
        LOG_ERR("Expected request, got type %d", cmd.cmd_type);
        return;
    }

    /* Look up handler */
    command_handler_fn handler = handlers_lookup(cmd.cmd_name, cmd.cmd_name_len);
    if (!handler) {
        LOG_ERR("Unknown command: %.*s", cmd.cmd_name_len, cmd.cmd_name);
        return;
    }

    /* Pass 1: Calculate protobuf encoded size (sizing stream, no I/O) */
    pb_ostream_t sizing = PB_OSTREAM_SIZING;
    int handler_rc = handler(cmd.data, cmd.data_len, &sizing);
    if (handler_rc == -2) {
        /* Handler manages its own response (e.g. stream handlers) */
        return;
    }
    if (handler_rc != 0) {
        LOG_ERR("Handler sizing pass failed");
        return;
    }
    size_t pb_size = sizing.bytes_written;

    /* Calculate total command payload size */
    size_t cmd_hdr_size = 2 + cmd.cmd_name_len + 2;
    size_t total_length = cmd_hdr_size + pb_size;

    /* Check response size against max */
    if (CONFIG_BLERPC_MAX_RESPONSE_PAYLOAD_SIZE < 65535 &&
        total_length > CONFIG_BLERPC_MAX_RESPONSE_PAYLOAD_SIZE) {
        uint8_t ctrl_buf[8];
        struct container_header ctrl = {
            .transaction_id = transaction_id,
            .sequence_number = 0,
            .type = CONTAINER_TYPE_CONTROL,
            .control_cmd = CONTROL_CMD_ERROR,
            .payload_len = 1,
        };
        uint8_t err_payload[1] = {BLERPC_ERROR_RESPONSE_TOO_LARGE};
        ctrl.payload = err_payload;
        int n = container_serialize(&ctrl, ctrl_buf, sizeof(ctrl_buf));
        if (n > 0) {
            send_with_retry(ctrl_buf, (size_t)n);
        }
        LOG_WRN("Response too large: %zu > %u", total_length,
                CONFIG_BLERPC_MAX_RESPONSE_PAYLOAD_SIZE);
        return;
    }

    /* Build command header */
    uint8_t cmd_hdr[20];
    cmd_hdr[0] = (COMMAND_TYPE_RESPONSE & 0x01) << 7;
    cmd_hdr[1] = cmd.cmd_name_len;
    memcpy(cmd_hdr + 2, cmd.cmd_name, cmd.cmd_name_len);
    size_t dl_offset = 2 + cmd.cmd_name_len;
    cmd_hdr[dl_offset] = (uint8_t)(pb_size & 0xFF);
    cmd_hdr[dl_offset + 1] = (uint8_t)((pb_size >> 8) & 0xFF);

    /* Set up streaming container sender */
    uint16_t mtu = ble_service_get_mtu();
    struct streaming_ctx sctx = {
        .transaction_id = transaction_id,
        .mtu = mtu,
        .total_length = (uint16_t)total_length,
    };

    /* Write command header into container stream */
    streaming_write(&sctx, cmd_hdr, cmd_hdr_size);

    /* Pass 2: Encode protobuf directly into container stream */
    pb_ostream_t ostream = {
        .callback = streaming_pb_callback,
        .state = &sctx,
        .max_size = SIZE_MAX,
        .bytes_written = 0,
    };

    if (handler(cmd.data, cmd.data_len, &ostream) != 0) {
        LOG_ERR("Handler encode pass failed");
        return;
    }

    /* Flush last partial container */
    streaming_flush_container(&sctx);

    if (sctx.error) {
        LOG_ERR("Streaming send failed: %d", sctx.error);
    }
}

static void request_work_handler(struct k_work *work)
{
    struct request_work *rw = CONTAINER_OF(work, struct request_work, work);
    process_request(rw->data, rw->len, rw->transaction_id);
}

/* ── BLE service ─────────────────────────────────────────────────────── */

static ssize_t on_write(struct bt_conn *conn, const struct bt_gatt_attr *attr, const void *buf,
                        uint16_t len, uint16_t offset, uint8_t flags)
{
    (void)attr;
    (void)offset;
    (void)flags;

    LOG_DBG("Write: %u bytes", len);

    struct container_header hdr;
    if (container_parse_header(buf, len, &hdr) != 0) {
        LOG_ERR("Container parse failed");
        return len;
    }

    /* Handle control containers inline (small, fast) */
    if (hdr.type == CONTAINER_TYPE_CONTROL) {
        if (hdr.control_cmd == CONTROL_CMD_TIMEOUT) {
            uint8_t ctrl_buf[8];
            struct container_header ctrl = {
                .transaction_id = hdr.transaction_id,
                .sequence_number = 0,
                .type = CONTAINER_TYPE_CONTROL,
                .control_cmd = CONTROL_CMD_TIMEOUT,
                .payload_len = 2,
            };
            uint8_t timeout_payload[2] = {
                (uint8_t)(CONFIG_BLERPC_TIMEOUT_MS & 0xFF),
                (uint8_t)(CONFIG_BLERPC_TIMEOUT_MS >> 8),
            };
            ctrl.payload = timeout_payload;
            int n = container_serialize(&ctrl, ctrl_buf, sizeof(ctrl_buf));
            if (n > 0) {
                ble_service_notify(ctrl_buf, (size_t)n);
            }
        } else if (hdr.control_cmd == CONTROL_CMD_STREAM_END_C2P) {
            if (stream_end_cb) {
                stream_end_cb(hdr.transaction_id);
            }
        } else if (hdr.control_cmd == CONTROL_CMD_CAPABILITIES) {
            uint8_t ctrl_buf[8];
            struct container_header ctrl = {
                .transaction_id = hdr.transaction_id,
                .sequence_number = 0,
                .type = CONTAINER_TYPE_CONTROL,
                .control_cmd = CONTROL_CMD_CAPABILITIES,
                .payload_len = 4,
            };
            uint8_t caps_payload[4];
            uint16_t max_req = CONFIG_BLERPC_PROTOCOL_ASSEMBLER_BUF_SIZE;
            uint16_t max_resp = CONFIG_BLERPC_MAX_RESPONSE_PAYLOAD_SIZE;
            caps_payload[0] = (uint8_t)(max_req & 0xFF);
            caps_payload[1] = (uint8_t)(max_req >> 8);
            caps_payload[2] = (uint8_t)(max_resp & 0xFF);
            caps_payload[3] = (uint8_t)(max_resp >> 8);
            ctrl.payload = caps_payload;
            int n = container_serialize(&ctrl, ctrl_buf, sizeof(ctrl_buf));
            if (n > 0) {
                ble_service_notify(ctrl_buf, (size_t)n);
            }
        }
        return len;
    }

    /* Feed into assembler */
    int rc = container_assembler_feed(&assembler, &hdr);
    if (rc == 1) {
        /* Assembly complete — process via work queue to free BT RX thread */
        req_work.transaction_id = hdr.transaction_id;
        req_work.len = assembler.total_length;
        memcpy(req_work.data, assembler.buf, assembler.total_length);
        container_assembler_init(&assembler);
        k_work_submit_to_queue(&blerpc_work_q, &req_work.work);
    } else if (rc < 0) {
        container_assembler_init(&assembler);
    }

    return len;
}

/* GATT service definition */
BT_GATT_SERVICE_DEFINE(blerpc_svc, BT_GATT_PRIMARY_SERVICE(&blerpc_svc_uuid),
                       BT_GATT_CHARACTERISTIC(&blerpc_char_uuid.uuid,
                                              BT_GATT_CHRC_WRITE_WITHOUT_RESP | BT_GATT_CHRC_NOTIFY,
                                              BT_GATT_PERM_WRITE, NULL, on_write, NULL),
                       BT_GATT_CCC(NULL, BT_GATT_PERM_READ | BT_GATT_PERM_WRITE), );

uint16_t ble_service_get_mtu(void)
{
    if (current_conn) {
        return bt_gatt_get_mtu(current_conn);
    }
    return 23; /* Default minimum */
}

int ble_service_notify(const uint8_t *data, size_t len)
{
    if (!current_conn) {
        return -ENOTCONN;
    }

    struct bt_gatt_notify_params params = {
        .attr = &blerpc_svc.attrs[2],
        .data = data,
        .len = len,
    };

    return bt_gatt_notify_cb(current_conn, &params);
}

static void connected(struct bt_conn *conn, uint8_t err)
{
    if (err) {
        LOG_ERR("Connection failed (err %u)", err);
        return;
    }
    LOG_INF("Connected");
    current_conn = bt_conn_ref(conn);
    container_assembler_init(&assembler);
}

static const struct bt_data ad[] = {
    BT_DATA_BYTES(BT_DATA_FLAGS, (BT_LE_AD_GENERAL | BT_LE_AD_NO_BREDR)),
    BT_DATA_BYTES(BT_DATA_UUID128_ALL, BLERPC_SERVICE_UUID),
};

static const struct bt_data sd[] = {
    BT_DATA(BT_DATA_NAME_COMPLETE,
            CONFIG_BLERPC_DEVICE_NAME,
            sizeof(CONFIG_BLERPC_DEVICE_NAME) - 1),
};

static void disconnected(struct bt_conn *conn, uint8_t reason)
{
    LOG_INF("Disconnected (reason %u)", reason);
    if (current_conn) {
        bt_conn_unref(current_conn);
        current_conn = NULL;
    }
    container_assembler_init(&assembler);

    int err = ble_service_start_advertising();
    if (err) {
        LOG_ERR("Failed to restart advertising (err %d)", err);
    }
}

int ble_service_start_advertising(void)
{
    return bt_le_adv_start(BT_LE_ADV_CONN, ad, ARRAY_SIZE(ad), sd, ARRAY_SIZE(sd));
}

BT_CONN_CB_DEFINE(conn_callbacks) = {
    .connected = connected,
    .disconnected = disconnected,
};

void ble_service_init(void)
{
    k_work_queue_init(&blerpc_work_q);
    k_work_queue_start(&blerpc_work_q, blerpc_work_stack, K_THREAD_STACK_SIZEOF(blerpc_work_stack),
                       K_PRIO_COOP(7), NULL);
    k_work_init(&req_work.work, request_work_handler);
    container_assembler_init(&assembler);
}

int ble_service_send_stream_end_p2c(uint8_t transaction_id)
{
    uint8_t ctrl_buf[8];
    struct container_header ctrl = {
        .transaction_id = transaction_id,
        .sequence_number = 0,
        .type = CONTAINER_TYPE_CONTROL,
        .control_cmd = CONTROL_CMD_STREAM_END_P2C,
        .payload_len = 0,
    };
    ctrl.payload = NULL;
    int n = container_serialize(&ctrl, ctrl_buf, sizeof(ctrl_buf));
    if (n < 0) {
        return -1;
    }
    return send_with_retry(ctrl_buf, (size_t)n);
}

void ble_service_set_stream_end_cb(ble_service_stream_end_cb_t cb)
{
    stream_end_cb = cb;
}

uint8_t ble_service_next_transaction_id(void)
{
    return transaction_counter++;
}

void ble_service_submit_work(struct k_work *work)
{
    k_work_submit_to_queue(&blerpc_work_q, work);
}
```

## src/ble_service.h
```c
#ifndef BLERPC_BLE_SERVICE_H
#define BLERPC_BLE_SERVICE_H

#include <zephyr/bluetooth/bluetooth.h>
#include <zephyr/bluetooth/gatt.h>

#ifdef __cplusplus
extern "C" {
#endif

/* blerpc Service UUID: 12340001-0000-1000-8000-00805f9b34fb */
#define BLERPC_SERVICE_UUID BT_UUID_128_ENCODE(0x12340001, 0x0000, 0x1000, 0x8000, 0x00805f9b34fb)

/* blerpc Characteristic UUID: 12340002-0000-1000-8000-00805f9b34fb */
#define BLERPC_CHAR_UUID BT_UUID_128_ENCODE(0x12340002, 0x0000, 0x1000, 0x8000, 0x00805f9b34fb)

/**
 * Initialize the BLE service (work queue, assembler).
 * Call after bt_enable() but before starting advertising.
 */
void ble_service_init(void);

/**
 * Start BLE advertising.
 * @return 0 on success, negative on error
 */
int ble_service_start_advertising(void);

/**
 * Get the current connection's MTU.
 */
uint16_t ble_service_get_mtu(void);

/**
 * Send a notification to the connected Central.
 * @param data  Data to send
 * @param len   Length of data
 * @return 0 on success, negative on error
 */
int ble_service_notify(const uint8_t *data, size_t len);

/**
 * Send a STREAM_END_P2C control container.
 * @param transaction_id Transaction ID
 * @return 0 on success, negative on error
 */
int ble_service_send_stream_end_p2c(uint8_t transaction_id);

/**
 * Callback type for stream end notification (C->P).
 * Called when STREAM_END_C2P is received from Central.
 */
typedef void (*ble_service_stream_end_cb_t)(uint8_t transaction_id);

/**
 * Register a callback for STREAM_END_C2P reception.
 */
void ble_service_set_stream_end_cb(ble_service_stream_end_cb_t cb);

/**
 * Get the next transaction ID (incrementing counter).
 */
uint8_t ble_service_next_transaction_id(void);

/**
 * Submit work to the blerpc work queue (has sufficient stack for BLE I/O).
 */
void ble_service_submit_work(struct k_work *work);

#ifdef __cplusplus
}
#endif

#endif /* BLERPC_BLE_SERVICE_H */
```

## src/blerpc.pb.c
```c
/* Automatically generated nanopb constant definitions */
/* Generated by nanopb-0.4.9.1 */

#include "blerpc.pb.h"
#if PB_PROTO_HEADER_VERSION != 40
#error Regenerate this file with the current version of nanopb generator.
#endif

PB_BIND(blerpc_EchoRequest, blerpc_EchoRequest, 2)


PB_BIND(blerpc_EchoResponse, blerpc_EchoResponse, 2)


PB_BIND(blerpc_FlashReadRequest, blerpc_FlashReadRequest, AUTO)


PB_BIND(blerpc_FlashReadResponse, blerpc_FlashReadResponse, AUTO)


PB_BIND(blerpc_DataWriteRequest, blerpc_DataWriteRequest, AUTO)


PB_BIND(blerpc_DataWriteResponse, blerpc_DataWriteResponse, AUTO)


PB_BIND(blerpc_CounterStreamRequest, blerpc_CounterStreamRequest, AUTO)


PB_BIND(blerpc_CounterStreamResponse, blerpc_CounterStreamResponse, AUTO)


PB_BIND(blerpc_CounterUploadRequest, blerpc_CounterUploadRequest, AUTO)


PB_BIND(blerpc_CounterUploadResponse, blerpc_CounterUploadResponse, AUTO)
```

## src/blerpc.pb.h
```c
/* Automatically generated nanopb header */
/* Generated by nanopb-0.4.9.1 */

#ifndef PB_BLERPC_BLERPC_PB_H_INCLUDED
#define PB_BLERPC_BLERPC_PB_H_INCLUDED
#include <pb.h>

#if PB_PROTO_HEADER_VERSION != 40
#error Regenerate this file with the current version of nanopb generator.
#endif

/* Struct definitions */
typedef struct _blerpc_EchoRequest {
    char message[257];
} blerpc_EchoRequest;

typedef struct _blerpc_EchoResponse {
    char message[257];
} blerpc_EchoResponse;

typedef struct _blerpc_FlashReadRequest {
    uint32_t address;
    uint32_t length;
} blerpc_FlashReadRequest;

typedef struct _blerpc_FlashReadResponse {
    uint32_t address;
    pb_callback_t data;
} blerpc_FlashReadResponse;

typedef struct _blerpc_DataWriteRequest {
    pb_callback_t data;
} blerpc_DataWriteRequest;

typedef struct _blerpc_DataWriteResponse {
    uint32_t length;
} blerpc_DataWriteResponse;

typedef struct _blerpc_CounterStreamRequest {
    uint32_t count;
} blerpc_CounterStreamRequest;

typedef struct _blerpc_CounterStreamResponse {
    uint32_t seq;
    int32_t value;
} blerpc_CounterStreamResponse;

typedef struct _blerpc_CounterUploadRequest {
    uint32_t seq;
    int32_t value;
} blerpc_CounterUploadRequest;

typedef struct _blerpc_CounterUploadResponse {
    uint32_t received_count;
} blerpc_CounterUploadResponse;


#ifdef __cplusplus
extern "C" {
#endif

/* Initializer values for message structs */
#define blerpc_EchoRequest_init_default          {""}
#define blerpc_EchoResponse_init_default         {""}
#define blerpc_FlashReadRequest_init_default     {0, 0}
#define blerpc_FlashReadResponse_init_default    {0, {{NULL}, NULL}}
#define blerpc_DataWriteRequest_init_default     {{{NULL}, NULL}}
#define blerpc_DataWriteResponse_init_default    {0}
#define blerpc_CounterStreamRequest_init_default {0}
#define blerpc_CounterStreamResponse_init_default {0, 0}
#define blerpc_CounterUploadRequest_init_default {0, 0}
#define blerpc_CounterUploadResponse_init_default {0}
#define blerpc_EchoRequest_init_zero             {""}
#define blerpc_EchoResponse_init_zero            {""}
#define blerpc_FlashReadRequest_init_zero        {0, 0}
#define blerpc_FlashReadResponse_init_zero       {0, {{NULL}, NULL}}
#define blerpc_DataWriteRequest_init_zero        {{{NULL}, NULL}}
#define blerpc_DataWriteResponse_init_zero       {0}
#define blerpc_CounterStreamRequest_init_zero    {0}
#define blerpc_CounterStreamResponse_init_zero   {0, 0}
#define blerpc_CounterUploadRequest_init_zero    {0, 0}
#define blerpc_CounterUploadResponse_init_zero   {0}

/* Field tags (for use in manual encoding/decoding) */
#define blerpc_EchoRequest_message_tag           1
#define blerpc_EchoResponse_message_tag          1
#define blerpc_FlashReadRequest_address_tag      1
#define blerpc_FlashReadRequest_length_tag       2
#define blerpc_FlashReadResponse_address_tag     1
#define blerpc_FlashReadResponse_data_tag        2
#define blerpc_DataWriteRequest_data_tag         1
#define blerpc_DataWriteResponse_length_tag      1
#define blerpc_CounterStreamRequest_count_tag    1
#define blerpc_CounterStreamResponse_seq_tag     1
#define blerpc_CounterStreamResponse_value_tag   2
#define blerpc_CounterUploadRequest_seq_tag      1
#define blerpc_CounterUploadRequest_value_tag    2
#define blerpc_CounterUploadResponse_received_count_tag 1

/* Struct field encoding specification for nanopb */
#define blerpc_EchoRequest_FIELDLIST(X, a) \
X(a, STATIC,   SINGULAR, STRING,   message,           1)
#define blerpc_EchoRequest_CALLBACK NULL
#define blerpc_EchoRequest_DEFAULT NULL

#define blerpc_EchoResponse_FIELDLIST(X, a) \
X(a, STATIC,   SINGULAR, STRING,   message,           1)
#define blerpc_EchoResponse_CALLBACK NULL
#define blerpc_EchoResponse_DEFAULT NULL

#define blerpc_FlashReadRequest_FIELDLIST(X, a) \
X(a, STATIC,   SINGULAR, UINT32,   address,           1) \
X(a, STATIC,   SINGULAR, UINT32,   length,            2)
#define blerpc_FlashReadRequest_CALLBACK NULL
#define blerpc_FlashReadRequest_DEFAULT NULL

#define blerpc_FlashReadResponse_FIELDLIST(X, a) \
X(a, STATIC,   SINGULAR, UINT32,   address,           1) \
X(a, CALLBACK, SINGULAR, BYTES,    data,              2)
#define blerpc_FlashReadResponse_CALLBACK pb_default_field_callback
#define blerpc_FlashReadResponse_DEFAULT NULL

#define blerpc_DataWriteRequest_FIELDLIST(X, a) \
X(a, CALLBACK, SINGULAR, BYTES,    data,              1)
#define blerpc_DataWriteRequest_CALLBACK pb_default_field_callback
#define blerpc_DataWriteRequest_DEFAULT NULL

#define blerpc_DataWriteResponse_FIELDLIST(X, a) \
X(a, STATIC,   SINGULAR, UINT32,   length,            1)
#define blerpc_DataWriteResponse_CALLBACK NULL
#define blerpc_DataWriteResponse_DEFAULT NULL

#define blerpc_CounterStreamRequest_FIELDLIST(X, a) \
X(a, STATIC,   SINGULAR, UINT32,   count,             1)
#define blerpc_CounterStreamRequest_CALLBACK NULL
#define blerpc_CounterStreamRequest_DEFAULT NULL

#define blerpc_CounterStreamResponse_FIELDLIST(X, a) \
X(a, STATIC,   SINGULAR, UINT32,   seq,               1) \
X(a, STATIC,   SINGULAR, INT32,    value,             2)
#define blerpc_CounterStreamResponse_CALLBACK NULL
#define blerpc_CounterStreamResponse_DEFAULT NULL

#define blerpc_CounterUploadRequest_FIELDLIST(X, a) \
X(a, STATIC,   SINGULAR, UINT32,   seq,               1) \
X(a, STATIC,   SINGULAR, INT32,    value,             2)
#define blerpc_CounterUploadRequest_CALLBACK NULL
#define blerpc_CounterUploadRequest_DEFAULT NULL

#define blerpc_CounterUploadResponse_FIELDLIST(X, a) \
X(a, STATIC,   SINGULAR, UINT32,   received_count,    1)
#define blerpc_CounterUploadResponse_CALLBACK NULL
#define blerpc_CounterUploadResponse_DEFAULT NULL

extern const pb_msgdesc_t blerpc_EchoRequest_msg;
extern const pb_msgdesc_t blerpc_EchoResponse_msg;
extern const pb_msgdesc_t blerpc_FlashReadRequest_msg;
extern const pb_msgdesc_t blerpc_FlashReadResponse_msg;
extern const pb_msgdesc_t blerpc_DataWriteRequest_msg;
extern const pb_msgdesc_t blerpc_DataWriteResponse_msg;
extern const pb_msgdesc_t blerpc_CounterStreamRequest_msg;
extern const pb_msgdesc_t blerpc_CounterStreamResponse_msg;
extern const pb_msgdesc_t blerpc_CounterUploadRequest_msg;
extern const pb_msgdesc_t blerpc_CounterUploadResponse_msg;

/* Defines for backwards compatibility with code written before nanopb-0.4.0 */
#define blerpc_EchoRequest_fields &blerpc_EchoRequest_msg
#define blerpc_EchoResponse_fields &blerpc_EchoResponse_msg
#define blerpc_FlashReadRequest_fields &blerpc_FlashReadRequest_msg
#define blerpc_FlashReadResponse_fields &blerpc_FlashReadResponse_msg
#define blerpc_DataWriteRequest_fields &blerpc_DataWriteRequest_msg
#define blerpc_DataWriteResponse_fields &blerpc_DataWriteResponse_msg
#define blerpc_CounterStreamRequest_fields &blerpc_CounterStreamRequest_msg
#define blerpc_CounterStreamResponse_fields &blerpc_CounterStreamResponse_msg
#define blerpc_CounterUploadRequest_fields &blerpc_CounterUploadRequest_msg
#define blerpc_CounterUploadResponse_fields &blerpc_CounterUploadResponse_msg

/* Maximum encoded size of messages (where known) */
/* blerpc_FlashReadResponse_size depends on runtime parameters */
/* blerpc_DataWriteRequest_size depends on runtime parameters */
#define BLERPC_BLERPC_PB_H_MAX_SIZE              blerpc_EchoRequest_size
#define blerpc_CounterStreamRequest_size         6
#define blerpc_CounterStreamResponse_size        17
#define blerpc_CounterUploadRequest_size         17
#define blerpc_CounterUploadResponse_size        6
#define blerpc_DataWriteResponse_size            6
#define blerpc_EchoRequest_size                  259
#define blerpc_EchoResponse_size                 259
#define blerpc_FlashReadRequest_size             12

#ifdef __cplusplus
} /* extern "C" */
#endif

#endif
```

## src/command.c
```c
#include "command.h"
#include <string.h>

int command_parse(const uint8_t *src, size_t src_len, struct command_packet *out)
{
    if (!src || !out || src_len < 2) {
        return -1;
    }

    /* Byte 0: type in MSB (bit 7) */
    out->cmd_type = (src[0] >> 7) & 0x01;
    out->cmd_name_len = src[1];

    size_t offset = 2;
    if (src_len < offset + out->cmd_name_len + 2) {
        return -1;
    }

    out->cmd_name = (const char *)(src + offset);
    offset += out->cmd_name_len;

    /* data_len: little-endian uint16 */
    out->data_len = (uint16_t)src[offset] | ((uint16_t)src[offset + 1] << 8);
    offset += 2;

    if (src_len < offset + out->data_len) {
        return -1;
    }

    out->data = src + offset;
    return 0;
}

int command_serialize(uint8_t cmd_type, const char *cmd_name, uint8_t cmd_name_len,
                      const uint8_t *data, uint16_t data_len, uint8_t *buf, size_t buf_size)
{
    size_t total = 2 + cmd_name_len + 2 + data_len;
    if (!buf || buf_size < total) {
        return -1;
    }

    /* Byte 0: type in MSB */
    buf[0] = (cmd_type & 0x01) << 7;
    buf[1] = cmd_name_len;

    if (cmd_name_len > 0 && cmd_name) {
        memcpy(buf + 2, cmd_name, cmd_name_len);
    }

    size_t offset = 2 + cmd_name_len;
    buf[offset] = (uint8_t)(data_len & 0xFF);
    buf[offset + 1] = (uint8_t)(data_len >> 8);
    offset += 2;

    if (data_len > 0 && data) {
        memcpy(buf + offset, data, data_len);
    }

    return (int)total;
}
```

## src/command.h
```c
#ifndef BLERPC_COMMAND_H
#define BLERPC_COMMAND_H

#include <stdint.h>
#include <stddef.h>

#ifdef __cplusplus
extern "C" {
#endif

/* Command types */
#define COMMAND_TYPE_REQUEST 0
#define COMMAND_TYPE_RESPONSE 1

/**
 * Parsed command packet.
 * data pointer is zero-copy into source buffer.
 */
struct command_packet {
    uint8_t cmd_type; /* COMMAND_TYPE_* */
    uint8_t cmd_name_len;
    const char *cmd_name; /* Points into source buffer, NOT null-terminated */
    uint16_t data_len;
    const uint8_t *data; /* Points into source buffer */
};

/**
 * Parse a command packet from a buffer.
 * Zero-copy: cmd_name and data point into src.
 * Returns 0 on success, -1 on error.
 */
int command_parse(const uint8_t *src, size_t src_len, struct command_packet *out);

/**
 * Serialize a command packet into a buffer.
 * Returns number of bytes written, or -1 on error.
 */
int command_serialize(uint8_t cmd_type, const char *cmd_name, uint8_t cmd_name_len,
                      const uint8_t *data, uint16_t data_len, uint8_t *buf, size_t buf_size);

#ifdef __cplusplus
}
#endif

#endif /* BLERPC_COMMAND_H */
```

## src/container.c
```c
#include "container.h"
#include <string.h>

static uint8_t pack_flags(uint8_t type, uint8_t control_cmd)
{
    return ((type & 0x03) << 6) | ((control_cmd & 0x0F) << 2);
}

static void unpack_flags(uint8_t flags, uint8_t *type, uint8_t *control_cmd)
{
    *type = (flags >> 6) & 0x03;
    *control_cmd = (flags >> 2) & 0x0F;
}

int container_parse_header(const uint8_t *data, size_t len, struct container_header *out)
{
    if (!data || !out || len < 4) {
        return -1;
    }

    out->transaction_id = data[0];
    out->sequence_number = data[1];
    unpack_flags(data[2], &out->type, &out->control_cmd);

    if (out->type == CONTAINER_TYPE_FIRST) {
        if (len < CONTAINER_FIRST_HEADER_SIZE) {
            return -1;
        }
        out->total_length = (uint16_t)data[3] | ((uint16_t)data[4] << 8);
        out->payload_len = data[5];
        out->payload = data + CONTAINER_FIRST_HEADER_SIZE;

        if (len < (size_t)CONTAINER_FIRST_HEADER_SIZE + out->payload_len) {
            return -1;
        }
    } else {
        out->total_length = 0;
        out->payload_len = data[3];
        out->payload = data + CONTAINER_SUBSEQUENT_HEADER_SIZE;

        if (len < (size_t)CONTAINER_SUBSEQUENT_HEADER_SIZE + out->payload_len) {
            return -1;
        }
    }

    return 0;
}

int container_serialize(const struct container_header *hdr, uint8_t *buf, size_t buf_size)
{
    if (!hdr || !buf) {
        return -1;
    }

    size_t header_size;
    if (hdr->type == CONTAINER_TYPE_FIRST) {
        header_size = CONTAINER_FIRST_HEADER_SIZE;
    } else {
        header_size = CONTAINER_SUBSEQUENT_HEADER_SIZE;
    }

    size_t total = header_size + hdr->payload_len;
    if (buf_size < total) {
        return -1;
    }

    buf[0] = hdr->transaction_id;
    buf[1] = hdr->sequence_number;
    buf[2] = pack_flags(hdr->type, hdr->control_cmd);

    if (hdr->type == CONTAINER_TYPE_FIRST) {
        buf[3] = (uint8_t)(hdr->total_length & 0xFF);
        buf[4] = (uint8_t)(hdr->total_length >> 8);
        buf[5] = hdr->payload_len;
    } else {
        buf[3] = hdr->payload_len;
    }

    if (hdr->payload_len > 0 && hdr->payload) {
        memcpy(buf + header_size, hdr->payload, hdr->payload_len);
    }

    return (int)total;
}

void container_assembler_init(struct container_assembler *a)
{
    if (!a)
        return;
    memset(a, 0, sizeof(*a));
    a->active = false;
}

int container_assembler_feed(struct container_assembler *a, const struct container_header *hdr)
{
    if (!a || !hdr) {
        return -1;
    }

    /* Ignore control containers */
    if (hdr->type == CONTAINER_TYPE_CONTROL) {
        return 0;
    }

    if (hdr->type == CONTAINER_TYPE_FIRST) {
        a->transaction_id = hdr->transaction_id;
        a->total_length = hdr->total_length;
        a->expected_seq = 1;
        a->received_length = 0;
        a->active = true;

        if (a->total_length > CONTAINER_ASSEMBLER_BUF_SIZE) {
            container_assembler_init(a);
            return -1;
        }
        if (hdr->payload_len > 0) {
            memcpy(a->buf, hdr->payload, hdr->payload_len);
            a->received_length = hdr->payload_len;
        }
    } else if (hdr->type == CONTAINER_TYPE_SUBSEQUENT) {
        if (!a->active || hdr->transaction_id != a->transaction_id) {
            container_assembler_init(a);
            return -1;
        }
        if (hdr->sequence_number != a->expected_seq) {
            container_assembler_init(a);
            return -1;
        }
        if (a->received_length + hdr->payload_len > CONTAINER_ASSEMBLER_BUF_SIZE) {
            container_assembler_init(a);
            return -1;
        }
        memcpy(a->buf + a->received_length, hdr->payload, hdr->payload_len);
        a->received_length += hdr->payload_len;
        a->expected_seq++;
    }

    if (a->received_length >= a->total_length) {
        a->active = false;
        return 1; /* Assembly complete */
    }

    return 0; /* More containers needed */
}

int container_split_and_send(uint8_t transaction_id, const uint8_t *payload, size_t payload_len,
                             uint16_t mtu, container_send_fn send_fn, void *ctx)
{
    if (!send_fn) {
        return -1;
    }

    uint16_t effective_mtu = mtu - CONTAINER_ATT_OVERHEAD;
    uint8_t buf[256]; /* Max single BLE packet */

    /* First container */
    uint8_t first_max = (uint8_t)(effective_mtu - CONTAINER_FIRST_HEADER_SIZE);
    uint8_t first_len = (payload_len < first_max) ? (uint8_t)payload_len : first_max;

    struct container_header hdr = {
        .transaction_id = transaction_id,
        .sequence_number = 0,
        .type = CONTAINER_TYPE_FIRST,
        .control_cmd = CONTROL_CMD_NONE,
        .total_length = (uint16_t)payload_len,
        .payload_len = first_len,
        .payload = payload,
    };

    int n = container_serialize(&hdr, buf, sizeof(buf));
    if (n < 0)
        return -1;
    int rc = send_fn(buf, (size_t)n, ctx);
    if (rc < 0)
        return rc;

    size_t offset = first_len;
    uint8_t seq = 1;
    uint8_t sub_max = (uint8_t)(effective_mtu - CONTAINER_SUBSEQUENT_HEADER_SIZE);

    while (offset < payload_len) {
        uint8_t chunk_len =
            ((payload_len - offset) < sub_max) ? (uint8_t)(payload_len - offset) : sub_max;

        struct container_header sub_hdr = {
            .transaction_id = transaction_id,
            .sequence_number = seq,
            .type = CONTAINER_TYPE_SUBSEQUENT,
            .control_cmd = CONTROL_CMD_NONE,
            .total_length = 0,
            .payload_len = chunk_len,
            .payload = payload + offset,
        };

        n = container_serialize(&sub_hdr, buf, sizeof(buf));
        if (n < 0)
            return -1;
        rc = send_fn(buf, (size_t)n, ctx);
        if (rc < 0)
            return rc;

        offset += chunk_len;
        seq++;
    }

    return 0;
}
```

## src/container.h
```c
#ifndef BLERPC_CONTAINER_H
#define BLERPC_CONTAINER_H

#include <stdint.h>
#include <stddef.h>
#include <stdbool.h>

#ifdef __cplusplus
extern "C" {
#endif

/* Container types */
#define CONTAINER_TYPE_FIRST 0x00
#define CONTAINER_TYPE_SUBSEQUENT 0x01
#define CONTAINER_TYPE_CONTROL 0x03

/* Control commands */
#define CONTROL_CMD_NONE 0x00
#define CONTROL_CMD_TIMEOUT 0x01
#define CONTROL_CMD_STREAM_END_C2P 0x02
#define CONTROL_CMD_STREAM_END_P2C 0x03

/* Header sizes */
#define CONTAINER_FIRST_HEADER_SIZE 6
#define CONTAINER_SUBSEQUENT_HEADER_SIZE 4
#define CONTAINER_CONTROL_HEADER_SIZE 4
#define CONTAINER_ATT_OVERHEAD 3

/* Assembler buffer size (configurable) */
#ifndef CONTAINER_ASSEMBLER_BUF_SIZE
#define CONTAINER_ASSEMBLER_BUF_SIZE 4096
#endif

/**
 * Parsed container header.
 */
struct container_header {
    uint8_t transaction_id;
    uint8_t sequence_number;
    uint8_t type;          /* CONTAINER_TYPE_* */
    uint8_t control_cmd;   /* CONTROL_CMD_* */
    uint16_t total_length; /* Only valid for FIRST */
    uint8_t payload_len;
    const uint8_t *payload; /* Points into source buffer */
};

/**
 * Parse a raw BLE packet into a container header.
 * Returns 0 on success, -1 on error.
 * payload pointer will point into the source data buffer (zero-copy).
 */
int container_parse_header(const uint8_t *data, size_t len, struct container_header *out);

/**
 * Serialize a container header + payload into a buffer.
 * Returns number of bytes written, or -1 on error.
 */
int container_serialize(const struct container_header *hdr, uint8_t *buf, size_t buf_size);

/**
 * Container assembler state.
 */
struct container_assembler {
    uint8_t buf[CONTAINER_ASSEMBLER_BUF_SIZE];
    uint16_t total_length;
    uint16_t received_length;
    uint8_t expected_seq;
    uint8_t transaction_id;
    bool active;
};

/**
 * Initialize the assembler.
 */
void container_assembler_init(struct container_assembler *a);

/**
 * Feed a parsed container into the assembler.
 * Returns:
 *   0  if more containers needed
 *   1  if assembly complete (data in a->buf, length in a->total_length)
 *  -1  on error (sequence gap, overflow, etc.) — assembler is reset
 */
int container_assembler_feed(struct container_assembler *a, const struct container_header *hdr);

/**
 * Callback type for sending a container.
 * data: serialized container bytes, len: number of bytes.
 * Returns 0 on success, negative on error.
 */
typedef int (*container_send_fn)(const uint8_t *data, size_t len, void *ctx);

/**
 * Split payload into containers and send each via callback.
 * Returns 0 on success, negative on error.
 */
int container_split_and_send(uint8_t transaction_id, const uint8_t *payload, size_t payload_len,
                             uint16_t mtu, container_send_fn send_fn, void *ctx);

#ifdef __cplusplus
}
#endif

#endif /* BLERPC_CONTAINER_H */
```

## src/generated_handlers.c
```c
/* Auto-generated by generate-handlers — DO NOT EDIT */
#include "generated_handlers.h"
#include "blerpc.pb.h"
#include <pb_encode.h>
#include <pb_decode.h>
#include <string.h>

/* Discard callback for FT_CALLBACK fields during decode */
static bool discard_bytes_cb(pb_istream_t *stream, const pb_field_t *field,
                             void **arg)
{
    (void)field;
    (void)arg;
    uint8_t buf[64];
    size_t left = stream->bytes_left;
    while (left > 0) {
        size_t n = left < sizeof(buf) ? left : sizeof(buf);
        if (!pb_read(stream, buf, n)) return false;
        left -= n;
    }
    return true;
}

__attribute__((weak))
int handle_echo(const uint8_t *req_data, size_t req_len,
                    pb_ostream_t *ostream)
{
    blerpc_EchoRequest req = blerpc_EchoRequest_init_zero;
    pb_istream_t stream = pb_istream_from_buffer(req_data, req_len);
    if (!pb_decode(&stream, blerpc_EchoRequest_fields, &req)) return -1;

    blerpc_EchoResponse resp = blerpc_EchoResponse_init_zero;
    if (!pb_encode(ostream, blerpc_EchoResponse_fields, &resp)) return -1;
    return 0;
}

__attribute__((weak))
int handle_flash_read(const uint8_t *req_data, size_t req_len,
                          pb_ostream_t *ostream)
{
    blerpc_FlashReadRequest req = blerpc_FlashReadRequest_init_zero;
    pb_istream_t stream = pb_istream_from_buffer(req_data, req_len);
    if (!pb_decode(&stream, blerpc_FlashReadRequest_fields, &req)) return -1;

    blerpc_FlashReadResponse resp = blerpc_FlashReadResponse_init_zero;
    if (!pb_encode(ostream, blerpc_FlashReadResponse_fields, &resp)) return -1;
    return 0;
}

__attribute__((weak))
int handle_data_write(const uint8_t *req_data, size_t req_len,
                          pb_ostream_t *ostream)
{
    blerpc_DataWriteRequest req = blerpc_DataWriteRequest_init_zero;
    req.data.funcs.decode = discard_bytes_cb;
    pb_istream_t stream = pb_istream_from_buffer(req_data, req_len);
    if (!pb_decode(&stream, blerpc_DataWriteRequest_fields, &req)) return -1;

    blerpc_DataWriteResponse resp = blerpc_DataWriteResponse_init_zero;
    if (!pb_encode(ostream, blerpc_DataWriteResponse_fields, &resp)) return -1;
    return 0;
}

__attribute__((weak))
int handle_counter_stream(const uint8_t *req_data, size_t req_len,
                              pb_ostream_t *ostream)
{
    blerpc_CounterStreamRequest req = blerpc_CounterStreamRequest_init_zero;
    pb_istream_t stream = pb_istream_from_buffer(req_data, req_len);
    if (!pb_decode(&stream, blerpc_CounterStreamRequest_fields, &req)) return -1;

    blerpc_CounterStreamResponse resp = blerpc_CounterStreamResponse_init_zero;
    if (!pb_encode(ostream, blerpc_CounterStreamResponse_fields, &resp)) return -1;
    return 0;
}

__attribute__((weak))
int handle_counter_upload(const uint8_t *req_data, size_t req_len,
                              pb_ostream_t *ostream)
{
    blerpc_CounterUploadRequest req = blerpc_CounterUploadRequest_init_zero;
    pb_istream_t stream = pb_istream_from_buffer(req_data, req_len);
    if (!pb_decode(&stream, blerpc_CounterUploadRequest_fields, &req)) return -1;

    blerpc_CounterUploadResponse resp = blerpc_CounterUploadResponse_init_zero;
    if (!pb_encode(ostream, blerpc_CounterUploadResponse_fields, &resp)) return -1;
    return 0;
}

static const struct handler_entry handler_table[] = {
    {"echo", 4, handle_echo},
    {"flash_read", 10, handle_flash_read},
    {"data_write", 10, handle_data_write},
    {"counter_stream", 14, handle_counter_stream},
    {"counter_upload", 14, handle_counter_upload},
};

command_handler_fn handlers_lookup(const char *name, uint8_t name_len)
{
    size_t i;
    for (i = 0; i < sizeof(handler_table) / sizeof(handler_table[0]); i++) {
        if (handler_table[i].name_len == name_len &&
            memcmp(handler_table[i].name, name, name_len) == 0) {
            return handler_table[i].handler;
        }
    }
    return NULL;
}
```

## src/generated_handlers.h
```c
/* Auto-generated by generate-handlers — DO NOT EDIT */
#ifndef BLERPC_GENERATED_HANDLERS_H
#define BLERPC_GENERATED_HANDLERS_H

#include <stdint.h>
#include <stddef.h>
#include <pb_encode.h>

#ifdef __cplusplus
extern "C" {
#endif

typedef int (*command_handler_fn)(const uint8_t *req_data, size_t req_len,
                                  pb_ostream_t *ostream);

struct handler_entry {
    const char *name;
    uint8_t name_len;
    command_handler_fn handler;
};

command_handler_fn handlers_lookup(const char *name, uint8_t name_len);

int handle_echo(const uint8_t *req_data, size_t req_len,
                    pb_ostream_t *ostream);

int handle_flash_read(const uint8_t *req_data, size_t req_len,
                          pb_ostream_t *ostream);

int handle_data_write(const uint8_t *req_data, size_t req_len,
                          pb_ostream_t *ostream);

#ifdef __cplusplus
}
#endif

#endif /* BLERPC_GENERATED_HANDLERS_H */
```

## src/handlers.h
```c
#ifndef BLERPC_HANDLERS_H
#define BLERPC_HANDLERS_H

#include "generated_handlers.h"

/**
 * Initialize stream handlers (register STREAM_END_C2P callback).
 * Call after ble_service_init().
 */
void handlers_stream_init(void);

#endif /* BLERPC_HANDLERS_H */
```
