## CMakeLists.txt
```
cmake_minimum_required(VERSION 3.20.0)

# blerpc-protocol library (container + command layers)
set(BLERPC_PROTOCOL_DIR ${CMAKE_CURRENT_SOURCE_DIR}/../../blerpc-protocol/c
    CACHE PATH "Path to blerpc-protocol C library")
list(APPEND ZEPHYR_EXTRA_MODULES ${BLERPC_PROTOCOL_DIR})

find_package(Zephyr REQUIRED HINTS $ENV{ZEPHYR_BASE})
project(blerpc_peripheral)

# nanopb
list(APPEND CMAKE_MODULE_PATH ${ZEPHYR_BASE}/../modules/lib/nanopb/extra)
include(FindNanopb)

target_sources(app PRIVATE
    src/main.c
    src/ble_service.c
    src/handlers.c
    src/generated_handlers.c
)

# Generate the nanopb message code (blerpc.pb.c/.h) from the proto at build
# time so it always matches proto/blerpc.proto and proto/blerpc.options.
# Resolve to an absolute path (no "..") so protoc does not report the input as
# shadowed in --proto_path.
get_filename_component(BLERPC_PROTO_DIR ${CMAKE_CURRENT_SOURCE_DIR}/../proto ABSOLUTE)
# The nanopb runtime is already provided by CONFIG_NANOPB; keep standalone mode
# off so nanopb_generate_cpp does not add a duplicate runtime (multiple-definition).
set(NANOPB_GENERATE_CPP_STANDALONE OFF)
nanopb_generate_cpp(proto_srcs proto_hdrs
    RELPATH ${BLERPC_PROTO_DIR}
    ${BLERPC_PROTO_DIR}/blerpc.proto)
target_sources(app PRIVATE ${proto_srcs} ${proto_hdrs})

target_include_directories(app PRIVATE
    src
    ${CMAKE_CURRENT_BINARY_DIR}
)
```

## Kconfig
```
source "Kconfig.zephyr"

config BLERPC_DEVICE_NAME
	string "BLE device name for advertising"
	default "blerpc"

config BLERPC_TIMEOUT_MS
	int "Default timeout in milliseconds"
	default 100
	help
	  Default timeout value reported to Central via timeout control container.

config BLERPC_MAX_RESPONSE_PAYLOAD_SIZE
	int "Maximum response payload size"
	default 65535
	help
	  Maximum response payload size reported to Central via capabilities
	  control container. The streaming encoder has no buffer limit, so this
	  defaults to the protocol maximum (65535).

config BLERPC_WORK_STACK_SIZE
	int "Work queue stack size"
	default MAIN_STACK_SIZE
	help
	  Stack size for the blerpc request processing work queue.

config BLERPC_MIN_FLASH_READ_ADDRESS
	int "Minimum allowed flash read address"
	default 0
	help
	  Minimum address (inclusive) allowed for BLE flash_read requests.
	  Together with BLERPC_MAX_FLASH_READ_ADDRESS this bounds the flash
	  window flash_read may return. Set it to the start of the data region
	  you intend to expose.

config BLERPC_MAX_FLASH_READ_ADDRESS
	int "Maximum allowed flash read address"
	default 0
	help
	  Maximum address (exclusive) allowed for BLE flash_read requests.
	  flash_read is FAIL-CLOSED: when this is 0 (the default) every
	  flash_read request is rejected. To enable bounded reads, set this to
	  the end of the data region you intend to expose and set
	  BLERPC_MIN_FLASH_READ_ADDRESS to its start. Restrict the window to
	  data you are willing to expose.

config BLERPC_DOUBLE_BUFFER
	bool "Double-buffer request work queue"
	default n
	help
	  When enabled, uses two request_work buffers instead of one,
	  allowing a new request to be received while the previous one
	  is still being processed. This costs ~12KB extra RAM.
	  When disabled, a BUSY error is sent if a request arrives
	  while the previous one is still being processed.

config BLERPC_ENCRYPTION
	bool "Enable E2E encryption"
	default n
	depends on BLERPC_PROTOCOL_CRYPTO
	help
	  Enable E2E encryption on the peripheral.
	  X25519 keypair is generated ephemerally per session for forward secrecy.
	  Requires Ed25519 private key for authentication.

config BLERPC_ED25519_PRIVATE_KEY
	string "Ed25519 private key seed (hex, 64 chars)"
	default ""
	depends on BLERPC_ENCRYPTION
	help
	  Peripheral Ed25519 private key seed as hex string (32 bytes = 64 hex chars).
	  This key is used for device authentication (signing).
	  Store this in a git-ignored overlay file (e.g. keys.conf), not prj.conf.
```

## prj.conf
```kconfig
# Bluetooth
CONFIG_BT=y
CONFIG_BT_PERIPHERAL=y
CONFIG_BT_DEVICE_NAME="blerpc"
CONFIG_BT_DEVICE_APPEARANCE=0

# MTU - request large MTU for throughput
CONFIG_BT_L2CAP_TX_MTU=247
CONFIG_BT_BUF_ACL_TX_SIZE=251
CONFIG_BT_BUF_ACL_RX_SIZE=251
# GATT
CONFIG_BT_GATT_DYNAMIC_DB=n

# TX buffers for large multi-container responses
CONFIG_BT_L2CAP_TX_BUF_COUNT=20
CONFIG_BT_BUF_ACL_TX_COUNT=20
CONFIG_BT_CONN_TX_MAX=20

# nanopb
CONFIG_NANOPB=y

# Flash
CONFIG_FLASH=y

# Logging
CONFIG_LOG=y
CONFIG_LOG_DEFAULT_LEVEL=3

# Console via UART
CONFIG_CONSOLE=y
CONFIG_UART_CONSOLE=y
CONFIG_SERIAL=y

# UART logging backend
CONFIG_LOG_BACKEND_UART=y

# RTT logging backend
CONFIG_USE_SEGGER_RTT=y
CONFIG_LOG_BACKEND_RTT=y
CONFIG_LOG_BACKEND_RTT_MODE_DROP=y

# Connection parameters — pin the interval to 15 ms (12 * 1.25 ms) for throughput.
# Offering a 15-30 ms window instead makes every central pick 30 ms (the
# power-efficient end), which doubles round-trip latency. macOS, iOS 26 and
# Android 14 were all measured accepting a 15 ms-only request.
CONFIG_BT_PERIPHERAL_PREF_MIN_INT=12
CONFIG_BT_PERIPHERAL_PREF_MAX_INT=12
CONFIG_BT_PERIPHERAL_PREF_LATENCY=0
CONFIG_BT_PERIPHERAL_PREF_TIMEOUT=100

# blerpc specific
CONFIG_BLERPC_DEVICE_NAME="blerpc"
CONFIG_BLERPC_TIMEOUT_MS=100
CONFIG_BLERPC_PROTOCOL_ASSEMBLER_BUF_SIZE=12288
CONFIG_BLERPC_DOUBLE_BUFFER=y

# flash_read window (fail-closed by default; MAX=0 rejects every request).
# Expose a bounded [MIN, MAX) region so the flash_read demo/benchmark works.
# This window covers only the first 8 KB from address 0 (the bootloader region),
# which is exactly what the flash_read tests/benchmarks read (address=0,
# length<=8192). Keep it minimal: widening it exposes more flash, including the
# application image that holds the embedded Ed25519 key. Point MIN/MAX at a
# dedicated data partition instead if you need to expose application data.
CONFIG_BLERPC_MIN_FLASH_READ_ADDRESS=0
CONFIG_BLERPC_MAX_FLASH_READ_ADDRESS=8192

# Stack sizes
CONFIG_MAIN_STACK_SIZE=8192
CONFIG_SYSTEM_WORKQUEUE_STACK_SIZE=2048
CONFIG_BT_RX_STACK_SIZE=4096

# Heap for mbedTLS/PSA crypto operations
CONFIG_HEAP_MEM_POOL_SIZE=16384

# E2E Encryption
CONFIG_BLERPC_PROTOCOL_CRYPTO=y
CONFIG_BLERPC_ENCRYPTION=y
CONFIG_MBEDTLS=y
CONFIG_MBEDTLS_PSA_CRYPTO_C=y

# PSA algorithm support for E2E encryption
CONFIG_PSA_WANT_ALG_ECDH=y
CONFIG_PSA_WANT_ECC_MONTGOMERY_255=y
CONFIG_PSA_WANT_KEY_TYPE_ECC_KEY_PAIR_IMPORT=y
CONFIG_PSA_WANT_KEY_TYPE_ECC_KEY_PAIR_EXPORT=y
CONFIG_PSA_WANT_KEY_TYPE_ECC_KEY_PAIR_DERIVE=y
CONFIG_PSA_WANT_KEY_TYPE_ECC_PUBLIC_KEY=y
# Ed25519 signatures
CONFIG_PSA_WANT_ALG_PURE_EDDSA=y
CONFIG_PSA_WANT_ECC_TWISTED_EDWARDS_255=y
# AES-128-GCM
CONFIG_PSA_WANT_KEY_TYPE_AES=y
CONFIG_PSA_WANT_ALG_GCM=y
# HKDF-SHA256
CONFIG_PSA_WANT_ALG_HKDF=y
# SHA-512 required for Ed25519 (CRACEN workmem needs PSA_HASH_MAX_SIZE >= 64)
CONFIG_PSA_WANT_ALG_SHA_512=y

# Ed25519 private key: set in keys.conf (git-ignored overlay)
# CONFIG_BLERPC_ED25519_PRIVATE_KEY="<your-64-hex-chars>"
```

## boards/nrf54l15dk_nrf54l15_cpuapp.conf
```kconfig
# Nordic-specific: software BLE controller supports DLE
CONFIG_BT_CTLR_DATA_LENGTH_MAX=251
```

## boards/xg22_ek2710a.conf
```kconfig
# EFR32xG22E: 32 KB RAM
# blerpc assembler buffer (small — echo/flash_read requests are tiny)
CONFIG_BLERPC_PROTOCOL_ASSEMBLER_BUF_SIZE=256

# Fewer TX buffers (1 connection only)
CONFIG_BT_L2CAP_TX_BUF_COUNT=3
CONFIG_BT_BUF_ACL_TX_COUNT=3
CONFIG_BT_CONN_TX_MAX=3
CONFIG_BT_BUF_ACL_RX_COUNT=3

# BT stack memory — minimum viable for Silicon Labs HCI
CONFIG_BT_SILABS_HCI_BUFFER_MEMORY=3360
CONFIG_COMMON_LIBC_MALLOC_ARENA_SIZE=6144
CONFIG_MAIN_STACK_SIZE=1536
CONFIG_BLERPC_WORK_STACK_SIZE=1536
CONFIG_SYSTEM_WORKQUEUE_STACK_SIZE=512
CONFIG_BT_RX_STACK_SIZE=768

# Disable encryption and double buffer (not enough RAM)
CONFIG_BLERPC_DOUBLE_BUFFER=n
CONFIG_BLERPC_PROTOCOL_CRYPTO=n
CONFIG_BLERPC_ENCRYPTION=n
CONFIG_HEAP_MEM_POOL_SIZE=0

# Disable all PSA/mbedTLS crypto (inherited from prj.conf, not needed on xg22)
CONFIG_MBEDTLS=n
CONFIG_MBEDTLS_PSA_CRYPTO_C=n
CONFIG_PSA_WANT_ALG_ECDH=n
CONFIG_PSA_WANT_ECC_MONTGOMERY_255=n
CONFIG_PSA_WANT_KEY_TYPE_ECC_KEY_PAIR_IMPORT=n
CONFIG_PSA_WANT_KEY_TYPE_ECC_KEY_PAIR_EXPORT=n
CONFIG_PSA_WANT_KEY_TYPE_ECC_KEY_PAIR_DERIVE=n
CONFIG_PSA_WANT_KEY_TYPE_ECC_PUBLIC_KEY=n
CONFIG_PSA_WANT_ALG_PURE_EDDSA=n
CONFIG_PSA_WANT_ECC_TWISTED_EDWARDS_255=n
CONFIG_PSA_WANT_KEY_TYPE_AES=n
CONFIG_PSA_WANT_ALG_GCM=n
CONFIG_PSA_WANT_ALG_HKDF=n
CONFIG_PSA_WANT_ALG_SHA_512=n

# Disable flash to free RAM for RTT logging
CONFIG_FLASH=n

# Disable UART — use RTT console instead
CONFIG_UART_CONSOLE=n
CONFIG_SERIAL=n

# Minimal logging via RTT (printk → RTT console)
CONFIG_LOG=y
CONFIG_LOG_MODE_MINIMAL=y
CONFIG_CONSOLE=y
CONFIG_USE_SEGGER_RTT=y
CONFIG_RTT_CONSOLE=y
CONFIG_LOG_BACKEND_RTT=n
CONFIG_LOG_BACKEND_UART=n
CONFIG_SEGGER_RTT_BUFFER_SIZE_UP=128
```

## src/main.c
```c
#include <zephyr/kernel.h>
#include <zephyr/bluetooth/bluetooth.h>
#include <zephyr/logging/log.h>
#ifdef CONFIG_BLERPC_ENCRYPTION
#include <mbedtls/platform.h>
#endif

#include "ble_service.h"
#include "handlers.h"

LOG_MODULE_REGISTER(main, LOG_LEVEL_INF);

int main(void)
{
    int err;

#ifdef CONFIG_BLERPC_ENCRYPTION
    /* mbedTLS on NCS defaults mbedtls_calloc to a stub returning NULL.
     * Use Zephyr's k_calloc/k_free backed by CONFIG_HEAP_MEM_POOL_SIZE. */
    mbedtls_platform_set_calloc_free(k_calloc, k_free);
#endif

    err = bt_enable(NULL);
    if (err) {
        LOG_ERR("Bluetooth init failed (err %d)", err);
        return err;
    }
    LOG_INF("Bluetooth initialized");

    ble_service_init();
    handlers_stream_init();

    err = ble_service_start_advertising();
    if (err) {
        LOG_ERR("Advertising failed to start (err %d)", err);
        return err;
    }
    LOG_INF("Advertising started");

    return 0;
}
```

## src/ble_service.h
```c
#ifndef BLERPC_BLE_SERVICE_H
#define BLERPC_BLE_SERVICE_H

#include <zephyr/bluetooth/bluetooth.h>
#include <zephyr/bluetooth/gatt.h>

#ifdef __cplusplus
extern "C" {
#endif

/* blerpc Service UUID: 12340001-0000-1000-8000-00805f9b34fb */
#define BLERPC_SERVICE_UUID BT_UUID_128_ENCODE(0x12340001, 0x0000, 0x1000, 0x8000, 0x00805f9b34fb)

/* blerpc Characteristic UUID: 12340002-0000-1000-8000-00805f9b34fb */
#define BLERPC_CHAR_UUID BT_UUID_128_ENCODE(0x12340002, 0x0000, 0x1000, 0x8000, 0x00805f9b34fb)

/**
 * Initialize the BLE service (work queue, assembler).
 * Call after bt_enable() but before starting advertising.
 */
void ble_service_init(void);

/**
 * Start BLE advertising.
 * @return 0 on success, negative on error
 */
int ble_service_start_advertising(void);

/**
 * Get the current connection's MTU.
 */
uint16_t ble_service_get_mtu(void);

/**
 * Send a notification to the connected Central.
 * @param data  Data to send
 * @param len   Length of data
 * @return 0 on success, negative on error
 */
int ble_service_notify(const uint8_t *data, size_t len);

/**
 * Send a STREAM_END_P2C control container.
 * @param transaction_id Transaction ID
 * @return 0 on success, negative on error
 */
int ble_service_send_stream_end_p2c(uint8_t transaction_id);

/**
 * Callback type for stream end notification (C->P).
 * Called when STREAM_END_C2P is received from Central.
 */
typedef void (*ble_service_stream_end_cb_t)(uint8_t transaction_id);

/**
 * Register a callback for STREAM_END_C2P reception.
 */
void ble_service_set_stream_end_cb(ble_service_stream_end_cb_t cb);

/**
 * Get the next transaction ID (incrementing counter).
 */
uint8_t ble_service_next_transaction_id(void);

/**
 * Submit work to the blerpc work queue (has sufficient stack for BLE I/O).
 */
void ble_service_submit_work(struct k_work *work);

/**
 * Send a command response payload, encrypting if encryption is active.
 * Splits the (possibly encrypted) payload into containers and sends via notify.
 * @param transaction_id Transaction ID for the containers
 * @param cmd_data       Serialized command payload (unencrypted)
 * @param cmd_len        Length of command payload
 * @return 0 on success, negative on error
 */
int ble_service_send_command_response(uint8_t transaction_id, const uint8_t *cmd_data,
                                      size_t cmd_len);

#ifdef __cplusplus
}
#endif

#endif /* BLERPC_BLE_SERVICE_H */
```

## src/generated_handlers.h
```c
/* Auto-generated by generate-handlers — DO NOT EDIT */
#ifndef BLERPC_GENERATED_HANDLERS_H
#define BLERPC_GENERATED_HANDLERS_H

#include <stdint.h>
#include <stddef.h>
#include <pb_encode.h>

#ifdef __cplusplus
extern "C" {
#endif

typedef int (*command_handler_fn)(const uint8_t *req_data, size_t req_len,
                                  pb_ostream_t *ostream);

struct handler_entry {
    const char *name;
    uint8_t name_len;
    command_handler_fn handler;
};

command_handler_fn handlers_lookup(const char *name, uint8_t name_len);

int handle_echo(const uint8_t *req_data, size_t req_len,
                    pb_ostream_t *ostream);

int handle_flash_read(const uint8_t *req_data, size_t req_len,
                          pb_ostream_t *ostream);

int handle_data_write(const uint8_t *req_data, size_t req_len,
                          pb_ostream_t *ostream);

int handle_counter_stream(const uint8_t *req_data, size_t req_len,
                              pb_ostream_t *ostream);

int handle_counter_upload(const uint8_t *req_data, size_t req_len,
                              pb_ostream_t *ostream);

#ifdef __cplusplus
}
#endif

#endif /* BLERPC_GENERATED_HANDLERS_H */
```

## src/handlers.c
```c
#include "handlers.h"
#include "ble_service.h"
#include "blerpc.pb.h"
#include <blerpc_protocol/command.h>
#include <blerpc_protocol/container.h>
#include <pb_encode.h>
#include <pb_decode.h>
#include <string.h>
#include <zephyr/kernel.h>
#include <zephyr/sys/atomic.h>
#include <zephyr/logging/log.h>
#if IS_ENABLED(CONFIG_FLASH)
#include <zephyr/drivers/flash.h>
#endif

LOG_MODULE_REGISTER(handlers, LOG_LEVEL_INF);

#define MAX_FLASH_READ_SIZE 8192
#define MAX_COUNTER_STREAM_COUNT 10000

int handle_echo(const uint8_t *req_data, size_t req_len, pb_ostream_t *ostream)
{
    blerpc_EchoRequest req = blerpc_EchoRequest_init_zero;
    pb_istream_t stream = pb_istream_from_buffer(req_data, req_len);

    if (!pb_decode(&stream, blerpc_EchoRequest_fields, &req)) {
        LOG_ERR("Echo decode failed: %s", PB_GET_ERROR(&stream));
        return -1;
    }

    LOG_INF("Echo: \"%s\"", req.message);

    blerpc_EchoResponse resp = blerpc_EchoResponse_init_zero;
    strncpy(resp.message, req.message, sizeof(resp.message) - 1);

    if (!pb_encode(ostream, blerpc_EchoResponse_fields, &resp)) {
        LOG_ERR("Echo encode failed: %s", PB_GET_ERROR(ostream));
        return -1;
    }

    return 0;
}

#if IS_ENABLED(CONFIG_FLASH)

struct flash_encode_ctx {
    const struct device *flash_dev;
    uint32_t address;
    uint32_t length;
};

static bool flash_data_encode_cb(pb_ostream_t *stream, const pb_field_t *field, void *const *arg)
{
    struct flash_encode_ctx *ctx = *(struct flash_encode_ctx **)arg;

    if (!pb_encode_tag_for_field(stream, field))
        return false;
    if (!pb_encode_varint(stream, ctx->length))
        return false;

    /* Read flash in chunks and stream directly to protobuf encoder */
    uint8_t chunk[256];
    uint32_t addr = ctx->address;
    uint32_t remaining = ctx->length;
    while (remaining > 0) {
        uint32_t n = MIN(remaining, sizeof(chunk));
        if (flash_read(ctx->flash_dev, addr, chunk, n) != 0)
            return false;
        if (!pb_write(stream, chunk, n))
            return false;
        addr += n;
        remaining -= n;
    }
    return true;
}

int handle_flash_read(const uint8_t *req_data, size_t req_len, pb_ostream_t *ostream)
{
    blerpc_FlashReadRequest req = blerpc_FlashReadRequest_init_zero;
    pb_istream_t stream = pb_istream_from_buffer(req_data, req_len);

    if (!pb_decode(&stream, blerpc_FlashReadRequest_fields, &req)) {
        LOG_ERR("FlashRead decode failed: %s", PB_GET_ERROR(&stream));
        return -1;
    }

    LOG_INF("FlashRead: addr=0x%08x len=%u", req.address, req.length);

    if (req.length > MAX_FLASH_READ_SIZE) {
        LOG_ERR("FlashRead: requested length %u exceeds max %d", req.length, MAX_FLASH_READ_SIZE);
        return -1;
    }

    const struct device *flash_dev = DEVICE_DT_GET(DT_CHOSEN(zephyr_flash_controller));
    if (!device_is_ready(flash_dev)) {
        LOG_ERR("Flash device not ready");
        return -1;
    }

    /* Validate flash read address bounds (FAIL CLOSED).
     *
     * flash_read can return the contents of any flash address, so it is gated
     * behind an explicit, bounded read window [MIN, MAX) configured via Kconfig.
     * When MAX is 0 (the default) every request is rejected; configure the
     * window to cover only the data region you intend to expose. */
    if (CONFIG_BLERPC_MAX_FLASH_READ_ADDRESS == 0) {
        LOG_ERR("FlashRead disabled: no read window configured "
                "(set CONFIG_BLERPC_MIN/MAX_FLASH_READ_ADDRESS)");
        return -1;
    }
    if (req.length > 0) {
        uint64_t end = (uint64_t)req.address + req.length;
        if (req.address < (uint32_t)CONFIG_BLERPC_MIN_FLASH_READ_ADDRESS ||
            end > (uint64_t)CONFIG_BLERPC_MAX_FLASH_READ_ADDRESS) {
            LOG_ERR("FlashRead: range [0x%08x, 0x%llx) outside allowed window "
                    "[0x%x, 0x%x)",
                    req.address, (unsigned long long)end,
                    (unsigned int)CONFIG_BLERPC_MIN_FLASH_READ_ADDRESS,
                    (unsigned int)CONFIG_BLERPC_MAX_FLASH_READ_ADDRESS);
            return -1;
        }
    }

    struct flash_pages_info page_info;
    size_t page_count = flash_get_page_count(flash_dev);
    if (page_count > 0 && flash_get_page_info_by_idx(flash_dev, page_count - 1, &page_info) == 0) {
        size_t flash_size = page_info.start_offset + page_info.size;
        /* Check for integer overflow and out-of-bounds */
        if (req.length > 0 && ((uint64_t)req.address + req.length > flash_size ||
                               req.address + req.length < req.address)) {
            LOG_ERR("FlashRead: address 0x%08x + length %u out of bounds (flash_size=%zu)",
                    req.address, req.length, flash_size);
            return -1;
        }
    }

    struct flash_encode_ctx ctx = {
        .flash_dev = flash_dev,
        .address = req.address,
        .length = req.length,
    };

    blerpc_FlashReadResponse resp = blerpc_FlashReadResponse_init_zero;
    resp.address = req.address;
    resp.data.funcs.encode = flash_data_encode_cb;
    resp.data.arg = &ctx;

    if (!pb_encode(ostream, blerpc_FlashReadResponse_fields, &resp)) {
        LOG_ERR("FlashRead encode failed: %s", PB_GET_ERROR(ostream));
        return -1;
    }

    return 0;
}

#endif /* CONFIG_FLASH */

/* Callback for decoding DataWriteRequest.data — count bytes, discard data */
struct data_write_decode_ctx {
    uint32_t total_bytes;
};

static bool data_write_decode_cb(pb_istream_t *stream, const pb_field_t *field, void **arg)
{
    (void)field;
    struct data_write_decode_ctx *ctx = (struct data_write_decode_ctx *)*arg;

    size_t len = stream->bytes_left;
    ctx->total_bytes += (uint32_t)len;

    /* Discard data by reading into a small buffer */
    uint8_t discard[256];
    while (len > 0) {
        size_t n = MIN(len, sizeof(discard));
        if (!pb_read(stream, discard, n)) {
            return false;
        }
        len -= n;
    }
    return true;
}

/* ── counter_stream: P→C stream ───────────────────────────────────── */

static int send_one_counter_stream_response(uint32_t seq, int32_t value)
{
    blerpc_CounterStreamResponse resp = blerpc_CounterStreamResponse_init_zero;
    resp.seq = seq;
    resp.value = value;

    /* Encode protobuf to buffer */
    uint8_t pb_buf[blerpc_CounterStreamResponse_size];
    pb_ostream_t ostream = pb_ostream_from_buffer(pb_buf, sizeof(pb_buf));
    if (!pb_encode(&ostream, blerpc_CounterStreamResponse_fields, &resp)) {
        LOG_ERR("CounterStream encode failed");
        return -1;
    }

    /* Build command response */
    static uint8_t cmd_buf[64];
    int cmd_len = command_serialize(COMMAND_TYPE_RESPONSE, "counter_stream", 14, pb_buf,
                                    (uint16_t)ostream.bytes_written, cmd_buf, sizeof(cmd_buf));
    if (cmd_len < 0) {
        return -1;
    }

    /* Send via ble_service helper (handles encryption if active) */
    uint8_t tid = ble_service_next_transaction_id();
    return ble_service_send_command_response(tid, cmd_buf, (size_t)cmd_len);
}

int handle_counter_stream(const uint8_t *req_data, size_t req_len, pb_ostream_t *ostream)
{
    (void)ostream; /* Not used — we send responses directly */

    blerpc_CounterStreamRequest req = blerpc_CounterStreamRequest_init_zero;
    pb_istream_t stream = pb_istream_from_buffer(req_data, req_len);

    if (!pb_decode(&stream, blerpc_CounterStreamRequest_fields, &req)) {
        LOG_ERR("CounterStream decode failed: %s", PB_GET_ERROR(&stream));
        return -1;
    }

    LOG_INF("CounterStream: count=%u", req.count);

    if (req.count > MAX_COUNTER_STREAM_COUNT) {
        LOG_ERR("CounterStream: count %u exceeds max %d", req.count, MAX_COUNTER_STREAM_COUNT);
        return -1;
    }

    /* Send N responses, each with its own transaction_id */
    for (uint32_t i = 0; i < req.count; i++) {
        int rc = send_one_counter_stream_response(i, (int32_t)(i * 10));
        if (rc != 0) {
            LOG_ERR("CounterStream send %u failed: %d", i, rc);
            return -1;
        }
    }

    /* Send STREAM_END_P2C */
    uint8_t tid = ble_service_next_transaction_id();
    ble_service_send_stream_end_p2c(tid);

    /* Return -2: process_request will skip normal response */
    return -2;
}

/* ── counter_upload: C→P stream (accumulation) ────────────────────── */

static atomic_t upload_count;

static void send_upload_response(struct k_work *work);
static K_WORK_DEFINE(upload_response_work, send_upload_response);

static void on_stream_end_c2p(uint8_t transaction_id)
{
    (void)transaction_id;
    LOG_INF("STREAM_END_C2P received, upload_count=%ld", atomic_get(&upload_count));
    ble_service_submit_work(&upload_response_work);
}

int handle_counter_upload(const uint8_t *req_data, size_t req_len, pb_ostream_t *ostream)
{
    (void)ostream;

    blerpc_CounterUploadRequest req = blerpc_CounterUploadRequest_init_zero;
    pb_istream_t stream = pb_istream_from_buffer(req_data, req_len);

    if (!pb_decode(&stream, blerpc_CounterUploadRequest_fields, &req)) {
        LOG_ERR("CounterUpload decode failed: %s", PB_GET_ERROR(&stream));
        return -1;
    }

    atomic_inc(&upload_count);
    LOG_DBG("CounterUpload: seq=%u value=%d (total=%ld)", req.seq, req.value,
            atomic_get(&upload_count));

    /* Return -2: no response for individual stream messages */
    return -2;
}

static void send_upload_response(struct k_work *work)
{
    (void)work;

    atomic_val_t count = atomic_set(&upload_count, 0);

    LOG_INF("CounterUpload: sending response, received_count=%ld", count);

    /* Encode CounterUploadResponse */
    blerpc_CounterUploadResponse resp = blerpc_CounterUploadResponse_init_zero;
    resp.received_count = (uint32_t)count;

    uint8_t pb_buf[blerpc_CounterUploadResponse_size];
    pb_ostream_t ostream = pb_ostream_from_buffer(pb_buf, sizeof(pb_buf));
    if (!pb_encode(&ostream, blerpc_CounterUploadResponse_fields, &resp)) {
        LOG_ERR("CounterUploadResponse encode failed");
        return;
    }

    /* Build command response */
    static uint8_t cmd_buf[64];
    int cmd_len = command_serialize(COMMAND_TYPE_RESPONSE, "counter_upload", 14, pb_buf,
                                    (uint16_t)ostream.bytes_written, cmd_buf, sizeof(cmd_buf));
    if (cmd_len < 0) {
        LOG_ERR("Command serialize failed");
        return;
    }

    /* Send via ble_service helper (handles encryption if active) */
    uint8_t tid = ble_service_next_transaction_id();
    ble_service_send_command_response(tid, cmd_buf, (size_t)cmd_len);
}

void handlers_stream_init(void)
{
    ble_service_set_stream_end_cb(on_stream_end_c2p);
}

int handle_data_write(const uint8_t *req_data, size_t req_len, pb_ostream_t *ostream)
{
    struct data_write_decode_ctx decode_ctx = {.total_bytes = 0};

    blerpc_DataWriteRequest req = blerpc_DataWriteRequest_init_zero;
    req.data.funcs.decode = data_write_decode_cb;
    req.data.arg = &decode_ctx;

    pb_istream_t stream = pb_istream_from_buffer(req_data, req_len);
    if (!pb_decode(&stream, blerpc_DataWriteRequest_fields, &req)) {
        LOG_ERR("DataWrite decode failed: %s", PB_GET_ERROR(&stream));
        return -1;
    }

    LOG_INF("DataWrite: received %u bytes", decode_ctx.total_bytes);

    blerpc_DataWriteResponse resp = blerpc_DataWriteResponse_init_zero;
    resp.length = decode_ctx.total_bytes;

    if (!pb_encode(ostream, blerpc_DataWriteResponse_fields, &resp)) {
        LOG_ERR("DataWrite encode failed: %s", PB_GET_ERROR(ostream));
        return -1;
    }

    return 0;
}
```
